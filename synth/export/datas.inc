#ifdef USE_AMEN_01
static const unsigned char amen_01_data[] = {
#include "data/amen_01.inc"
};
#endif
#ifdef USE_AMEN_02
static const unsigned char amen_02_data[] = {
#include "data/amen_02.inc"
};
#endif
#ifdef USE_AMEN_03
static const unsigned char amen_03_data[] = {
#include "data/amen_03.inc"
};
#endif
#ifdef USE_AMEN_04
static const unsigned char amen_04_data[] = {
#include "data/amen_04.inc"
};
#endif
#ifdef USE_AMEN_05
static const unsigned char amen_05_data[] = {
#include "data/amen_05.inc"
};
#endif
#ifdef USE_AMEN_06
static const unsigned char amen_06_data[] = {
#include "data/amen_06.inc"
};
#endif
#ifdef USE_AMEN_07
static const unsigned char amen_07_data[] = {
#include "data/amen_07.inc"
};
#endif
#ifdef USE_AMEN_08
static const unsigned char amen_08_data[] = {
#include "data/amen_08.inc"
};
#endif
#ifdef USE_AMEN_09
static const unsigned char amen_09_data[] = {
#include "data/amen_09.inc"
};
#endif
#ifdef USE_AMEN_10
static const unsigned char amen_10_data[] = {
#include "data/amen_10.inc"
};
#endif
#ifdef USE_AMEN_11
static const unsigned char amen_11_data[] = {
#include "data/amen_11.inc"
};
#endif
#ifdef USE_AMEN_12
static const unsigned char amen_12_data[] = {
#include "data/amen_12.inc"
};
#endif
#ifdef USE_AMEN_13
static const unsigned char amen_13_data[] = {
#include "data/amen_13.inc"
};
#endif
#ifdef USE_AMEN_14
static const unsigned char amen_14_data[] = {
#include "data/amen_14.inc"
};
#endif
#ifdef USE_AMEN_15
static const unsigned char amen_15_data[] = {
#include "data/amen_15.inc"
};
#endif
#ifdef USE_AMEN_16
static const unsigned char amen_16_data[] = {
#include "data/amen_16.inc"
};
#endif
#ifdef USE_AMEN_17
static const unsigned char amen_17_data[] = {
#include "data/amen_17.inc"
};
#endif
#ifdef USE_AMEN_18
static const unsigned char amen_18_data[] = {
#include "data/amen_18.inc"
};
#endif
#ifdef USE_AMEN_19
static const unsigned char amen_19_data[] = {
#include "data/amen_19.inc"
};
#endif
#ifdef USE_AMEN_20
static const unsigned char amen_20_data[] = {
#include "data/amen_20.inc"
};
#endif
#ifdef USE_AMEN_21
static const unsigned char amen_21_data[] = {
#include "data/amen_21.inc"
};
#endif
#ifdef USE_AMEN_22
static const unsigned char amen_22_data[] = {
#include "data/amen_22.inc"
};
#endif
#ifdef USE_AMEN_23
static const unsigned char amen_23_data[] = {
#include "data/amen_23.inc"
};
#endif
#ifdef USE_AMEN_24
static const unsigned char amen_24_data[] = {
#include "data/amen_24.inc"
};
#endif
#ifdef USE_AMEN_25
static const unsigned char amen_25_data[] = {
#include "data/amen_25.inc"
};
#endif
#ifdef USE_AMEN_26
static const unsigned char amen_26_data[] = {
#include "data/amen_26.inc"
};
#endif
#ifdef USE_AMEN_27
static const unsigned char amen_27_data[] = {
#include "data/amen_27.inc"
};
#endif
#ifdef USE_AMEN_28
static const unsigned char amen_28_data[] = {
#include "data/amen_28.inc"
};
#endif
#ifdef USE_AMEN_29
static const unsigned char amen_29_data[] = {
#include "data/amen_29.inc"
};
#endif
#ifdef USE_AMEN_30
static const unsigned char amen_30_data[] = {
#include "data/amen_30.inc"
};
#endif
#ifdef USE_AMEN_31
static const unsigned char amen_31_data[] = {
#include "data/amen_31.inc"
};
#endif
#ifdef USE_AMEN_32
static const unsigned char amen_32_data[] = {
#include "data/amen_32.inc"
};
#endif
#ifdef USE_AMEN_33
static const unsigned char amen_33_data[] = {
#include "data/amen_33.inc"
};
#endif
#ifdef USE_AMEN_34
static const unsigned char amen_34_data[] = {
#include "data/amen_34.inc"
};
#endif
#ifdef USE_AMEN_35
static const unsigned char amen_35_data[] = {
#include "data/amen_35.inc"
};
#endif
#ifdef USE_AMEN_36
static const unsigned char amen_36_data[] = {
#include "data/amen_36.inc"
};
#endif
#ifdef USE_AMEN_37
static const unsigned char amen_37_data[] = {
#include "data/amen_37.inc"
};
#endif
#ifdef USE_AMEN_38
static const unsigned char amen_38_data[] = {
#include "data/amen_38.inc"
};
#endif
#ifdef USE_AMEN_39
static const unsigned char amen_39_data[] = {
#include "data/amen_39.inc"
};
#endif
#ifdef USE_AMEN_40
static const unsigned char amen_40_data[] = {
#include "data/amen_40.inc"
};
#endif
#ifdef USE_AMEN_41
static const unsigned char amen_41_data[] = {
#include "data/amen_41.inc"
};
#endif
#ifdef USE_AMEN_42
static const unsigned char amen_42_data[] = {
#include "data/amen_42.inc"
};
#endif
#ifdef USE_AMEN_43
static const unsigned char amen_43_data[] = {
#include "data/amen_43.inc"
};
#endif
#ifdef USE_AMEN_44
static const unsigned char amen_44_data[] = {
#include "data/amen_44.inc"
};
#endif
#ifdef USE_AMEN_45
static const unsigned char amen_45_data[] = {
#include "data/amen_45.inc"
};
#endif
#ifdef USE_AMEN_46
static const unsigned char amen_46_data[] = {
#include "data/amen_46.inc"
};
#endif
