#define USE_GURO_HTFL_HT_015_03
#define USE_GURO_SCFL_HT_015_03
#define USE_JK_PRC_03
#define USE_JK_PRC_04
#define USE_JK_PRC_05
#define USE_JK_PRC_06
#define USE_JK_PRC_09
#define USE_JK_PRC_10
#define USE_JK_SNR_01
#define USE_JK_SNR_02
#define USE_JK_SNR_03
#define USE_JK_SNR_04
#define USE_JK_SNR_07
#define USE_L400_SNR_DCFL_HT_03
#define USE_L400_SNR_DEFL_HT_03
#define USE_L400_SNR_DRFL_HT_03
#define USE_L400_SNR_LCFL_HT_03
#define USE_L400_SNR_LEFL_HT_03
#define USE_L400_SNR_LRFL_HT_03
#define USE_L400_SNR_OFFL_HT_03
#define USE_L400_SNR_XSFL_HT_03
#define USE_LWFI_SNR_DCFL_HT_03
#define USE_LWFI_SNR_DEFL_HT_03
#define USE_LWFI_SNR_DRFL_HT_03
#define USE_LWFI_SNR_LCFL_HT_03
#define USE_LWFI_SNR_LEFL_HT_03
#define USE_LWFI_SNR_LRFL_HT_03
#define USE_LWFI_SNR_OFFL_HT_03
#define USE_LWFI_SNR_XSFL_HT_03
#define USE_PSTE_CRSH_CNFL_HT_015_03
#define USE_PSTE_CRSH_EGFL_HT_015_03
#define USE_PSTE_RIDE_BLFL_HT_03
#define USE_PSTE_RIDE_CNFL_HT_03
#define USE_PSTE_RIDE_EGFL_HT_03
#define USE_RGRS_FTOM_CNFL_HT_03
#define USE_RGRS_KICK_HDFL_HT_03
#define USE_RGRS_KICK_SFFL_HT_03
#define USE_RGRS_RTOM_CNFL_HT_03
#define USE_SHKR_HDFL_HT_015_03
#define USE_SHKR_SFFL_HT_015_03
#define USE_TAMB_HTFL_HT_015_03
#define USE_TAMB_SHFL_HT_015_03
#define USE_ZDJN_HAT_C1EGFL_HT_015_01
#define USE_ZDJN_HAT_C1EGFL_HT_015_02
#define USE_ZDJN_HAT_C1EGFL_HT_015_03
#define USE_ZDJN_HAT_C1FL_HT_015_01
#define USE_ZDJN_HAT_C1FL_HT_015_02
#define USE_ZDJN_HAT_C1FL_HT_015_03
#define USE_ZDJN_HAT_C2EGFL_HT_015_01
#define USE_ZDJN_HAT_C2EGFL_HT_015_02
#define USE_ZDJN_HAT_C2EGFL_HT_015_03
#define USE_ZDJN_HAT_C2FL_HT_015_01
#define USE_ZDJN_HAT_C2FL_HT_015_02
#define USE_ZDJN_HAT_C2FL_HT_015_03
#define USE_ZDJN_HAT_C3EGFL_HT_015_03
#define USE_ZDJN_HAT_C3FL_HT_015_03
#define USE_ZDJN_HAT_O1EGFL_HT_015_03
#define USE_ZDJN_HAT_O1FL_HT_015_03
#define USE_ZDJN_HAT_O2EGFL_HT_015_03
#define USE_ZDJN_HAT_O2FL_HT_015_03
#define USE_ZDJN_HAT_O3EGFL_HT_015_03
#define USE_ZDJN_HAT_O3FL_HT_015_03
#define USE_ZDJN_HAT_POFL_HT_015_03
#define USE_ZDJN_HAT_PSFL_HT_015_01
#define USE_ZDJN_HAT_PSFL_HT_015_02
#define USE_ZDJN_HAT_PSFL_HT_015_03
#define USE_AMEN_01
#define USE_AMEN_02
#define USE_AMEN_03
#define USE_AMEN_04
#define USE_AMEN_05
#define USE_AMEN_06
#define USE_AMEN_07
#define USE_AMEN_08
#define USE_AMEN_09
#define USE_AMEN_10
#define USE_AMEN_11
#define USE_AMEN_12
#define USE_AMEN_13
#define USE_AMEN_14
#define USE_AMEN_15
#define USE_AMEN_16
#define USE_AMEN_17
#define USE_AMEN_18
#define USE_AMEN_19
#define USE_AMEN_20
#define USE_AMEN_21
#define USE_AMEN_22
#define USE_AMEN_23
#define USE_AMEN_24
#define USE_AMEN_25
#define USE_AMEN_26
#define USE_AMEN_27
#define USE_AMEN_28
#define USE_AMEN_29
#define USE_AMEN_30
#define USE_AMEN_31
#define USE_AMEN_32
#define USE_AMEN_33
#define USE_AMEN_34
#define USE_AMEN_35
#define USE_AMEN_36
#define USE_AMEN_37
#define USE_AMEN_38
#define USE_AMEN_39
#define USE_AMEN_40
#define USE_AMEN_41
#define USE_AMEN_42
#define USE_AMEN_43
#define USE_AMEN_44
#define USE_AMEN_45
#define USE_AMEN_46
#define USE_CLAP_808
#define USE_CLAP_ANALOG
#define USE_CLAP_CRUSHED
#define USE_CLAP_FAT
#define USE_CLAP_SLAPPER
#define USE_CLAP_TAPE
#define USE_COWBELL_808
#define USE_CRASH_808
#define USE_CRASH_ACOUSTIC
#define USE_CRASH_NOISE
#define USE_CRASH_TAPE
#define USE_HIHAT_808
#define USE_HIHAT_ACOUSTIC01
#define USE_HIHAT_ACOUSTIC02
#define USE_HIHAT_ANALOG
#define USE_HIHAT_DIGITAL
#define USE_HIHAT_DIST01
#define USE_HIHAT_DIST02
#define USE_HIHAT_ELECTRO
#define USE_HIHAT_PLAIN
#define USE_HIHAT_RESO
#define USE_HIHAT_RING
#define USE_KICK_808
#define USE_KICK_ACOUSTIC01
#define USE_KICK_ACOUSTIC02
#define USE_KICK_BIG
#define USE_KICK_CLASSIC
#define USE_KICK_CULTIVATOR
#define USE_KICK_DEEP
#define USE_KICK_DRY
#define USE_KICK_ELECTRO01
#define USE_KICK_ELECTRO02
#define USE_KICK_FLOPPY
#define USE_KICK_GRITTY
#define USE_KICK_HEAVY
#define USE_KICK_NEWWAVE
#define USE_KICK_OLDSCHOOL
#define USE_KICK_PLAIN
#define USE_KICK_SLAPBACK
#define USE_KICK_SOFTY
#define USE_KICK_STOMP
#define USE_KICK_TAPE
#define USE_KICK_THUMP
#define USE_KICK_TIGHT
#define USE_KICK_TRON
#define USE_KICK_VINYL01
#define USE_KICK_VINYL02
#define USE_KICK_ZAPPER
#define USE_OPENHAT_808
#define USE_OPENHAT_ACOUSTIC01
#define USE_OPENHAT_ANALOG
#define USE_OPENHAT_SLICK
#define USE_OPENHAT_TIGHT
#define USE_PERC_808
#define USE_PERC_CHIRPY
#define USE_PERC_HOLLOW
#define USE_PERC_LASER
#define USE_PERC_METAL
#define USE_PERC_NASTY
#define USE_PERC_SHORT
#define USE_PERC_TAMBO
#define USE_PERC_TRIBAL
#define USE_PERC_WEIRDO
#define USE_RIDE_ACOUSTIC01
#define USE_RIDE_ACOUSTIC02
#define USE_SHAKER_ANALOG
#define USE_SHAKER_SHUFFLE
#define USE_SHAKER_SUCKUP
#define USE_SNARE_808
#define USE_SNARE_ACOUSTIC01
#define USE_SNARE_ACOUSTIC02
#define USE_SNARE_ANALOG
#define USE_SNARE_BIG
#define USE_SNARE_BLOCK
#define USE_SNARE_BRUTE
#define USE_SNARE_DIST01
#define USE_SNARE_DIST02
#define USE_SNARE_DIST03
#define USE_SNARE_ELECTRO
#define USE_SNARE_LOFI01
#define USE_SNARE_LOFI02
#define USE_SNARE_MODULAR
#define USE_SNARE_NOISE
#define USE_SNARE_PINCH
#define USE_SNARE_PUNCH
#define USE_SNARE_SMASHER
#define USE_SNARE_SUMO
#define USE_SNARE_TAPE
#define USE_SNARE_VINYL01
#define USE_SNARE_VINYL02
#define USE_TOM_808
#define USE_TOM_ACOUSTIC01
#define USE_TOM_ACOUSTIC02
#define USE_TOM_ANALOG
#define USE_TOM_CHIPTUNE
#define USE_TOM_FM
#define USE_TOM_LOFI
#define USE_TOM_ROTOTOM
#define USE_TOM_SHORT
