27,155,6,121,210,219,142,45,48,161,23,92,9,59,17,143,169,87,77,65,194,192,214,146,48,112,129,36,3,60,165,180,50,227,85,99,226,203,203,5,166,195,78,141,4,226,197,69,81,9,236,151,87,22,50,224,117,5,178,0,120,77,22,14,99,65,77,165,179,83,149,65,85,14,92,228,0,100,212,114,229,8,80,93,118,65,32,120,65,212,64,89,128,23,83,33,14,80,23,214,20,129,200,12,68,80,20,164,35,123,29,5,85,148,142,47,212,121,1,148,44,192,0,86,23,160,212,227,64,81,85,1,130,79,121,65,84,69,22,0,176,83,21,84,65,4,8,94,208,17,20,85,80,2,236,120,20,229,128,20,3,17,21,81,85,69,214,229,14,94,69,5,133,5,212,84,85,68,16,17,121,21,20,100,7,69,68,84,69,21,84,81,81,85,80,5,145,93,20,68,68,84,69,68,21,69,21,65,4,217,85,5,21,229,68,118,73,71,68,68,5,85,69,68,69,100,117,20,25,69,85,85,23,82,23,121,129,53,17,21,20,80,68,68,65,4,85,149,117,85,17,148,53,81,69,65,65,68,145,87,65,85,118,80,68,81,20,21,17,20,80,84,68,20,5,20,16,17,80,5,84,17,17,85,85,20,17,68,68,84,100,71,20,5,81,69,81,100,85,29,85,84,17,21,17,65,17,81,17,81,84,81,17,65,118,85,85,85,68,68,68,85,85,68,84,17,17,85,68,16,85,85,85,85,100,71,84,21,17,149,85,117,68,68,86,