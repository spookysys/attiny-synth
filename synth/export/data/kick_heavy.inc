0,0,112,16,96,114,10,9,129,97,115,232,249,6,156,227,45,224,201,133,205,122,62,120,66,193,9,251,161,48,132,175,123,122,61,134,47,11,57,22,79,34,53,218,12,203,38,115,233,57,192,64,136,63,210,138,191,167,176,240,38,59,194,167,3,200,66,0,212,122,5,48,56,144,192,248,30,232,184,179,57,0,242,146,251,130,60,233,192,40,111,139,143,128,211,8,11,11,112,2,0,11,111,178,192,2,19,8,176,192,52,186,203,200,96,35,140,227,126,32,184,3,0,84,187,128,3,0,7,58,56,48,14,33,139,3,203,16,14,194,2,94,147,192,46,187,67,69,57,32,48,16,85,101,141,140,23,80,1,96,113,1,20,84,64,1,50,88,7,148,20,53,20,20,81,88,131,69,93,81,64,65,21,84,17,17,68,0,17,68,16,68,80,5,17,68,21,217,85,68,86,85,85,85,117,68,85,21,81,85,85,68,