103,104,18,246,36,147,188,9,135,75,20,99,12,30,14,67,250,0,225,248,114,2,240,178,27,200,192,142,131,129,12,48,56,64,130,59,187,131,23,9,142,239,224,0,89,56,128,23,99,77,128,0,192,0,64,17,133,131,12,128,53,85,21,5,148,23,64,65,17,65,69,86,84,13,148,83,64,65,89,21,151,227,128,53,20,20,65,225,224,224,20,64,17,17,133,3,14,0,5,5,81,85,56,224,94,120,81,16,17,5,32,3,0,20,84,89,21,20,59,110,77,97,85,29,214,238,14,88,83,20,145,93,142,59,0,80,20,68,68,1,200,0,0,69,65,68,80,56,14,120,65,1,17,81,0,184,131,69,93,84,100,91,227,0,64,89,87,85,148,23,32,69,93,20,149,85,23,120,1,69,68,69,81,69,81,69,100,85,213,97,71,68,68,4,81,17,17,81,21,65,16,85,85,21,145,