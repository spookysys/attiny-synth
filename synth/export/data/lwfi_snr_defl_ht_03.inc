166,137,105,44,176,76,158,114,91,222,91,21,103,20,34,188,177,147,128,220,73,254,164,109,211,102,171,171,114,165,43,156,203,216,180,209,135,118,231,6,4,29,230,105,116,16,244,73,216,54,109,118,69,199,137,97,219,52,97,16,85,196,97,247,38,61,49,98,218,39,97,156,183,17,198,97,244,161,77,68,99,16,29,216,158,118,244,38,209,33,121,208,36,97,87,157,155,135,29,231,198,25,65,99,155,93,109,159,217,196,77,154,167,93,29,182,77,70,67,218,85,213,93,181,6,228,109,132,109,71,99,216,213,73,158,7,25,125,64,182,121,112,86,77,18,209,24,144,71,213,134,29,45,73,159,109,30,83,167,246,198,217,230,49,117,74,208,21,73,108,92,149,4,221,129,230,241,86,96,83,69,