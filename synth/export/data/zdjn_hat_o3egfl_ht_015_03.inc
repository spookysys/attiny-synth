76,110,154,157,21,209,217,21,198,73,99,208,132,217,89,221,101,147,180,167,178,87,147,231,65,101,71,117,19,157,102,119,145,4,209,21,100,68,38,54,87,84,244,161,89,17,213,189,241,166,149,93,81,25,29,217,209,102,117,208,144,182,81,221,84,155,39,125,88,109,152,29,85,145,221,68,17,102,103,164,48,221,4,125,216,81,109,118,88,65,216,180,39,217,77,84,69,99,70,27,29,70,101,84,244,33,49,89,116,17,102,119,17,100,101,84,116,69,208,24,21,77,16,70,85,247,152,102,101,87,68,69,84,55,121,218,213,173,113,216,149,81,109,28,144,199,54,102,85,71,153,21,125,104,156,68,85,199,198,61,6,6,97,211,24,246,38,13,121,18,199,198,49,166,61,137,81,135,81,81,81,217,221,25,29,77,152,81,109,216,155,180,21,29,25,93,65,146,213,141,13,97,119,102,68,68,147,7,93,65,107,118,116,18,118,69,111,30,144,4,141,65,99,28,86,27,103,17,196,97,101,116,68,68,116,53,73,20,97,16,144,52,21,198,121,3,105,87,101,84,87,86,116,157,246,73,101,117,197,33,1,73,223,158,24,100,117,20,89,29,69,144,213,61,36,4,21,97,86,55,198,97,117,181,65,208,216,144,117,22,65,16,196,1,89,4,65,16,69,16,68,17,68,29,84,84,144,182,125,16,17,89,77,26,4,21,167,81,209,85,