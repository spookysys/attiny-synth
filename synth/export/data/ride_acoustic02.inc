76,174,73,20,97,151,77,229,73,87,85,213,97,100,87,118,247,9,65,145,54,109,100,87,147,69,144,213,65,28,27,7,164,77,37,97,87,7,65,16,155,246,230,113,145,103,29,107,158,119,73,92,97,151,77,151,6,125,145,152,4,93,84,16,70,183,189,121,214,73,156,117,24,217,213,231,86,158,116,145,85,17,85,153,29,157,157,157,221,246,38,77,157,156,219,70,102,116,119,16,96,18,69,28,101,103,68,68,116,53,121,86,29,148,121,72,208,69,144,29,68,17,70,69,219,68,29,133,65,83,4,4,69,146,29,4,97,19,69,108,30,70,118,69,245,33,109,68,147,118,217,144,118,85,87,216,71,65,96,208,133,65,208,133,109,197,105,53,65,145,52,135,84,216,68,109,18,117,88,109,92,105,223,64,133,6,81,199,152,102,103,247,21,24,69,156,117,30,219,70,102,87,68,52,121,216,217,36,113,3,38,77,145,68,17,87,218,71,89,81,209,