0,0,0,0,0,71,69,68,5,121,86,85,85,85,85,85,85,85,29,16,68,5,65,69,144,7,17,17,21,17,17,145,93,217,17,17,81,81,149,17,209,132,21,17,209,36,109,69,71,85,144,196,1,21,16,85,68,69,69,69,68,68,68,4,97,69,68,68,87,84,5,129,173,113,28,81,17,65,30,68,68,84,68,68,84,100,27,135,17,145,113,82,213,17,29,17,17,17,17,217,25,29,145,17,29,89,25,209,17,17,228,113,68,68,68,68,69,68,69,68,100,87,5,97,69,52,129,81,7,21,145,29,81,217,21,21,21,21,17,145,17,81,97,83,100,85,209,86,119,100,71,68,68,68,68,68,100,156,84,85,69,85,53,89,180,209,54,85,65,216,65,64,64,80,17,85,97,133,81,29,89,65,220,96,214,65,103,71,84,68,133,109,68,117,101,85,156,70,27,100,117,101,85,199,113,69,20,1,65,86,19,70,53,129,21,86,27,85,81,89,221,196,89,85,117,210,84,68,68,69,69,100,85,24,85,54,81,132,81,29,7,21,29,17,217,17,65,24,81,29,6,65,16,84,80,77,132,89,29,68,85,85,85,85,213,65,21,89,100,69,151,81,157,