155,102,199,193,161,113,30,199,105,24,7,4,81,29,4,97,27,29,180,17,209,132,217,100,85,157,183,54,109,68,100,147,52,39,228,121,24,77,30,24,7,36,65,86,7,65,16,196,49,121,18,4,109,116,145,132,109,19,132,113,218,39,77,108,64,16,149,157,221,132,21,17,213,102,183,149,81,77,216,89,77,76,80,228,38,65,208,24,4,65,67,112,66,18,135,93,113,94,6,237,137,97,211,144,4,65,16,4,89,29,4,65,86,7,65,208,24,100,117,208,144,132,109,84,71,17,4,65,86,135,109,84,7,65,16,100,117,220,26,228,73,79,218,39,125,64,96,208,24,135,17,17,17,93,65,154,221,155,196,173,77,86,52,113,64,18,246,129,89,21,109,219,155,196,49,97,84,19,144,7,21,164,189,73,16,196,1,73,67,216,93,164,109,156,118,85,55,54,70,145,213,65,16,4,97,219,155,196,73,28,152,85,29,135,21,93,65,146,213,113,80,81,21,36,65,91,209,81,77,24,81,77,24,81,217,149,209,21,36,65,16,231,97,69,69,71,7,105,111,146,213,65,28,156,144,7,231,198,121,210,16,86,116,152,213,13,1,121,165,109,211,16,24,180,213,145,17,29,81,81,230,105,159,147,244,73,16,4,97,211,84,16,20,33,73,156,183,70,117,212,129,97,27,213,89,221,24,39,65,16,182,77,24,39,125,24,113,90,209,