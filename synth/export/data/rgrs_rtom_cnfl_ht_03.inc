166,137,234,125,214,213,85,89,113,210,84,94,237,146,156,86,55,105,111,220,101,28,25,79,35,122,72,208,218,17,219,85,147,97,245,80,73,156,108,143,88,145,93,85,158,91,157,21,71,29,134,55,216,9,77,81,114,142,4,97,215,30,37,71,149,157,215,73,173,125,21,68,86,67,69,25,52,224,9,102,183,77,64,100,79,101,151,177,69,64,70,116,69,109,23,133,29,132,53,97,68,21,39,145,7,145,157,55,37,29,198,217,84,153,117,151,29,229,21,64,16,118,4,24,103,116,86,17,28,69,21,145,180,85,116,69,86,217,209,18,71,17,80,4,20,81,81,1,70,21,213,121,80,64,80,100,83,85,73,85,27,77,4,73,213,121,118,81,228,118,85,84,96,85,156,213,145,81,84,23,17,5,97,93,81,17,20,68,225,121,216,85,210,5,100,87,68,82,213,5,217,4,20,85,97,71,65,22,69,28,85,97,85,208,17,17,5,69,18,81,85,213,5,121,84,80,149,85,84,84,85,81,81,117,69,4,5,65,81,68,101,83,144,117,85,81,73,