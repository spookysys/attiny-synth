24,154,25,6,237,225,149,159,96,47,1,228,180,99,94,129,205,36,144,219,131,225,121,25,147,79,74,15,134,135,87,110,60,9,54,144,219,35,185,61,24,158,151,49,121,25,147,79,122,175,246,216,114,2,225,141,219,114,2,249,57,24,99,59,225,132,87,120,192,230,52,110,187,13,155,79,194,230,118,121,0,81,30,48,233,36,71,105,215,4,158,15,137,231,67,58,57,180,222,142,198,144,179,137,93,208,190,185,231,210,224,201,135,110,203,225,158,222,235,6,156,140,1,39,99,192,185,27,112,50,6,67,122,229,52,98,143,39,208,8,1,155,111,44,167,87,176,45,147,44,249,6,123,122,181,216,35,1,155,79,200,182,76,2,13,78,122,229,7,14,57,158,64,227,54,120,56,54,94,57,4,94,57,39,30,229,21,64,44,135,112,8,135,12,9,27,48,9,147,236,185,28,194,33,111,194,1,78,238,228,120,200,21,190,57,27,48,230,67,122,85,126,50,84,142,81,99,3,100,109,