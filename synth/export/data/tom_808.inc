107,74,224,249,197,36,151,151,220,32,120,249,146,3,140,0,129,191,130,199,46,140,192,9,94,0,147,236,178,204,137,48,46,19,8,131,203,225,142,140,219,224,200,0,228,238,224,76,186,131,123,181,56,242,96,172,131,3,21,56,248,114,2,56,48,144,56,94,110,195,130,195,1,160,175,215,9,248,142,7,8,0,80,141,128,215,216,8,192,0,225,194,238,84,46,236,0,1,178,12,118,33,59,94,4,50,142,71,57,50,80,70,177,112,21,57,14,120,20,128,123,217,5,224,80,4,229,56,69,64,201,229,81,0,0,20,185,53,80,68,121,1,80,89,3,20,84,72,77,81,21,0,20,17,225,5,69,133,69,93,68,81,0,68,21,5,20,118,65,65,21,4,20,5,85,81,64,17,17,101,77,69,21,84,89,85,81,69,85,117,21,16,69,70,21,85,213,84,81,68,65,17,17,217,5,17,145,93,20,145,29,65,17,65,64,85,17,17,85,16,81,89,