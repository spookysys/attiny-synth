166,166,81,117,82,77,145,84,143,121,245,98,176,193,101,94,65,157,80,193,230,69,222,153,117,94,61,104,94,237,101,94,237,101,30,145,87,30,25,87,64,103,94,121,116,66,3,69,248,161,71,198,155,83,182,211,122,100,188,225,100,228,93,126,148,94,73,85,197,149,83,149,111,120,29,194,164,215,33,220,34,87,232,13,78,25,222,133,20,177,219,235,19,202,39,206,6,114,187,0,129,28,131,94,185,71,1,208,232,52,46,19,250,228,8,135,0,81,203,54,50,132,227,4,194,1,128,7,242,6,224,180,200,21,190,16,142,7,44,208,226,147,236,114,2,30,227,142,45,120,236,56,36,172,93,140,147,176,147,64,77,32,99,35,197,1,46,13,0,144,131,147,91,67,37,92,1,214,70,193,81,96,77,0,64,0,5,228,37,21,69,93,129,69,151,69,85,212,84,88,84,117,121,5,20,69,0,69,64,21,4,20,100,93,5,1,5,73,