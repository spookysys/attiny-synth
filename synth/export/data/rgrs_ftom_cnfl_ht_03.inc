106,106,131,93,64,91,84,68,151,231,152,29,69,87,87,8,57,228,197,9,155,219,92,228,134,61,16,122,37,157,77,67,229,6,208,130,81,119,6,49,57,141,158,64,48,65,97,212,228,81,69,128,113,65,82,81,85,213,36,65,116,78,140,4,144,119,5,21,20,153,29,17,221,185,77,26,84,147,217,31,66,132,132,157,199,151,100,113,163,183,109,70,222,108,39,249,161,116,21,52,149,180,39,209,38,17,29,161,205,105,183,93,68,80,81,23,4,37,57,121,29,84,16,80,24,69,197,81,238,201,69,20,4,16,145,84,85,77,50,81,80,6,4,85,151,81,68,23,81,198,65,164,157,157,125,68,24,39,77,133,118,85,217,29,65,4,1,100,69,117,6,21,117,110,83,20,4,84,148,13,85,65,24,69,87,84,80,21,65,54,1,54,121,96,84,84,116,97,16,81,85,29,4,85,17,118,69,22,21,85,213,81,80,145,81,69,19,101,20,