154,217,158,37,182,116,27,240,144,194,118,6,124,148,8,29,129,220,100,242,70,36,99,84,237,180,145,60,121,33,210,103,248,144,20,0,65,167,143,121,198,75,210,225,84,80,11,7,80,2,39,68,62,132,83,242,154,116,120,85,30,193,155,208,9,19,66,167,119,9,157,76,37,95,58,149,158,93,28,98,199,222,160,118,48,141,110,231,76,34,103,51,6,72,7,108,176,18,13,180,32,209,51,38,104,119,121,0,30,228,244,186,210,228,135,172,52,193,182,140,208,230,189,2,118,197,54,194,18,39,7,46,208,24,28,178,75,99,112,46,131,228,1,13,238,146,7,183,200,43,121,12,201,72,217,118,209,200,172,193,201,57,248,72,114,110,131,99,157,16,159,56,108,153,199,180,224,67,165,7,180,224,68,152,244,21,62,18,25,27,55,136,87,145,28,80,57,123,85,226,249,9,94,71,38,7,147,78,77,80,122,64,227,66,69,36,7,27,44,87,68,74,53,13,200,21,20,178,121,3,14,81,88,222,120,14,94,21,148,30,99,3,64,5,20,114,66,20,212,81,18,57,121,69,113,85,64,129,4,7,214,84,80,80,110,112,94,64,148,117,1,228,84,94,144,69,17,121,64,197,85,68,65,81,210,64,229,69,16,121,21,16,94,1,21,217,148,85,19,94,65,17,17,80,85,30,88,213,69,20,85,16,121,0,21,84,85,84,65,4,228,84,20,21,217,84,217,97,212,21,69,100,84,21,29,68,65,69,17,17,84,149,29,4,5,97,85,117,4,17,17,4,144,85,71,21,85,69,84,144,23,1,81,100,87,17,145,209,5,65,100,117,68,17,21,217,81,16,68,84,69,85,21,217,81,84,69,68,100,87,