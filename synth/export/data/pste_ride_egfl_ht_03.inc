48,105,31,4,169,97,118,102,147,39,65,28,118,117,197,73,87,36,121,18,85,39,61,105,118,5,153,28,7,4,122,163,247,6,77,31,100,54,45,230,97,69,118,181,113,30,246,105,87,85,244,249,41,65,24,198,121,99,219,4,21,155,182,109,118,31,24,132,185,188,109,19,4,65,118,208,208,218,68,101,219,118,213,97,85,152,167,125,218,39,77,219,81,97,156,100,117,24,39,77,16,182,77,223,38,73,28,103,118,85,71,102,119,85,25,182,77,216,180,36,113,28,36,97,84,199,105,19,101,219,70,71,209,26,135,221,102,69,70,159,147,199,105,155,221,145,157,213,81,100,85,117,131,121,107,159,182,113,210,85,155,39,65,86,135,77,28,54,73,156,85,85,29,144,117,108,99,155,221,7,16,216,153,228,121,216,149,209,217,213,68,17,167,93,29,86,26,103,213,121,88,29,17,145,77,26,213,113,18,196,89,157,4,113,30,182,97,211,100,159,208,18,52,97,216,147,118,69,84,246,185,65,86,52,237,33,97,84,103,100,183,77,68,28,219,25,70,145,39,125,16,149,125,146,209,183,146,4,97,156,246,73,31,26,182,77,219,93,93,164,109,155,221,101,211,102,70,181,113,108,156,196,97,100,87,147,100,117,152,221,87,18,196,65,69,157,146,4,113,158,199,70,21,97,118,19,196,13,6,109,102,87,27,182,109,219,7,157,213,69,72,146,213,113,96,216,100,199,13,39,69,104,16,4,113,26,39,125,218,54,113,18,4,65,86,103,117,91,81,217,149,209,213,4,167,157,93,149,29,93,209,100,153,221,246,36,100,157,69,16,167,113,78,26,221,144,118,117,216,52,134,217,77,156,246,65,24,180,29,65,30,152,228,105,19,55,54,65,24,196,228,81,85,85,17,244,152,71,89,65,210,27,21,97,23,89,29,180,134,125,20,228,49,65,6,105,111,18,4,65,16,4,113,158,7,228,173,217,125,208,141,161,97,219,55,144,102,247,102,29,215,1,70,145,29,70,69,16,52,121,22,228,230,121,216,149,125,110,156,213,121,210,116,54,198,36,209,97,23,38,113,70,28,216,118,68,25,4,109,84,54,121,112,26,93,65,216,85,25,221,29,71,153,164,109,84,7,109,53,49,65,155,102,117,211,52,134,97,28,156,100,7,45,65,118,79,154,217,21,29,213,6,77,145,52,6,97,156,246,225,73,118,5,97,19,70,55,213,216,216,154,213,97,219,100,117,156,196,97,52,105,31,180,73,158,7,109,156,147,54,89,85,85,221,158,147,246,73,87,69,216,84,158,244,121,26,231,36,93,117,96,91,29,65,22,81,182,77,156,167,113,210,85,117,218,246,89,85,132,125,131,109,102,87,118,87,16,86,84,87,197,137,13,89,85,7,36,65,95,70,149,13,33,113,181,132,153,93,81,93,213,36,217,65,118,16,69,220,104,208,68,99,218,155,135,29,29,109,158,84,86,71,180,81,29,6,121,30,7,89,221,18,84,69,5,141,4,209,6,13,6,54,149,77,18,52,54,6,61,65,86,54,1,109,21,97,156,68,69,211,146,101,219,69,86,52,109,71,155,135,4,217,205,169,109,87,117,68,86,85,84,24,39,109,159,155,39,109,147,39,109,159,116,101,86,68,247,36,36,109,100,119,52,1,65,68,101,68,4,97,69,27,103,85,39,109,71,116,132,89,149,125,172,89,29,182,125,107,151,217,61,185,230,73,219,135,198,73,79,218,167,125,78,218,85,221,100,118,101,68,5,105,27,213,113,107,118,211,144,4,65,216,182,109,84,135,77,219,145,213,180,182,81,157,228,73,219,228,73,219,85,21,209,81,155,4,65,28,27,6,173,113,210,70,247,21,70,27,155,4,65,118,216,183,6,121,30,199,105,144,39,77,147,231,164,125,218,198,73,156,7,81,21,217,217,141,121,30,182,113,30,180,65,158,244,36,81,17,167,93,85,209,180,149,109,216,70,117,16,198,73,159,132,113,210,85,117,72,18,199,167,209,36,81,69,208,118,27,68,153,213,17,21,4,217,189,73,28,156,68,99,210,219,144,4,97,118,87,77,72,116,210,146,52,228,73,16,4,113,107,116,75,76,70,208,86,151,65,118,216,155,7,217,167,93,77,84,65,80,36,81,100,85,52,109,246,105,100,87,19,28,22,149,231,109,70,23,73,219,89,65,30,118,116,53,81,86,5,121,108,116,104,208,155,209,246,97,69,102,87,70,116,117,145,102,247,149,54,81,