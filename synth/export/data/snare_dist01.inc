106,106,163,205,70,125,105,240,9,120,26,65,1,7,189,249,72,114,102,23,100,50,93,99,34,124,143,144,214,57,237,101,215,136,249,57,212,230,107,92,96,158,135,126,136,211,133,112,157,226,249,20,232,224,112,100,20,213,99,171,47,215,152,151,85,240,84,84,72,222,69,102,108,92,40,79,162,170,185,54,27,102,31,92,146,186,207,73,124,20,66,150,78,87,85,87,53,24,156,102,119,156,24,165,235,138,86,144,117,76,118,229,213,136,49,157,97,209,128,49,209,230,159,58,1,83,166,29,213,146,247,217,181,146,86,71,16,219,116,216,25,155,69,219,85,113,72,101,103,135,77,118,118,208,96,76,3,73,26,85,213,65,79,146,81,189,141,68,93,97,246,201,132,159,151,25,39,167,209,21,145,17,25,209,21,221,153,209,17,149,17,145,209,221,17,77,154,221,100,100,183,125,148,153,29,81,217,17,145,209,93,149,21,153,221,217,209,196,84,24,81,213,146,159,216,70,157,118,