155,170,224,3,13,158,124,130,231,187,57,101,243,98,126,109,142,23,201,227,129,192,110,254,232,96,254,194,66,232,85,227,185,112,21,64,2,223,33,66,122,61,109,98,11,23,244,38,6,252,136,65,75,32,63,78,122,72,50,204,150,121,111,58,188,23,137,7,233,12,67,148,78,6,44,211,81,41,68,176,60,84,102,78,52,194,91,157,230,19,185,251,68,84,234,221,186,67,85,100,78,213,224,76,69,166,223,230,56,84,69,38,55,57,206,100,85,233,85,47,126,85,102,206,217,139,79,69,36,122,244,136,31,17,165,222,49,58,84,69,164,31,228,224,85,109,230,83,5,0,71,81,10,119,194,50,68,149,200,83,224,66,85,101,193,116,50,14,145,49,226,71,184,76,85,22,184,221,56,72,85,148,51,17,224,120,20,148,126,69,238,22,81,20,112,68,9,117,20,165,87,7,82,151,93,56,64,70,13,68,132,197,84,21,94,84,101,237,85,101,81,71,81,0,145,85,28,17,69,1,85,5,5,89,85,208,81,84,65,68,80,20,17,20,85,85,65,17,81,5,17,21,69,17,81,101,85,85,23,17,17,84,85,85,20,81,89,85,117,80,69,68,4,17,17,149,85,85,117,118,68,20,17,17,145,85,85,29,149,85,