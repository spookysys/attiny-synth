152,26,96,64,53,110,94,39,111,66,117,121,37,69,251,144,66,5,71,132,84,197,86,37,221,137,29,121,118,11,93,8,89,53,65,132,221,33,29,185,39,145,244,145,70,183,71,39,218,85,158,7,105,116,123,80,133,125,152,246,97,136,123,181,205,19,147,169,240,173,125,144,118,7,158,68,18,7,121,16,237,113,9,6,17,246,65,26,221,96,31,41,113,4,198,65,26,221,96,84,13,73,7,198,65,218,85,101,71,175,113,155,196,109,30,84,65,23,43,49,25,52,157,64,23,186,113,173,228,109,18,55,105,119,184,61,88,26,55,105,19,189,93,172,216,80,96,30,228,121,27,68,21,117,94,37,121,156,118,85,109,95,8,121,21,198,109,210,27,121,92,37,54,103,18,118,115,82,181,231,91,218,27,121,222,36,4,157,16,23,37,121,144,196,65,30,84,77,75,36,36,221,155,116,37,61,37,198,17,144,183,73,211,230,196,20,210,16,41,97,183,167,221,67,88,35,73,52,36,221,216,70,59,121,81,146,7,73,28,198,113,36,196,69,73,30,228,49,17,16,20,133,113,36,13,217,68,