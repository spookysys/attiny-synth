156,36,149,135,4,21,39,17,113,210,7,101,158,70,7,97,87,101,159,180,217,77,70,156,246,73,215,97,135,65,216,116,65,218,103,4,109,245,137,97,211,70,27,55,26,54,77,85,155,157,167,109,28,86,119,213,89,246,38,141,113,80,17,217,69,218,52,6,189,81,100,231,105,159,159,18,118,117,144,213,81,6,97,87,85,116,209,146,196,97,71,70,52,73,28,118,68,52,105,219,70,85,180,109,118,219,100,135,217,125,16,81,145,25,81,217,29,77,18,102,183,77,118,152,209,4,125,146,85,217,132,209,217,109,19,102,183,109,118,156,70,183,217,77,152,209,4,217,77,152,221,182,217,217,109,219,102,183,109,118,19,102,183,209,97,118,19,182,209,97,118,19,102,183,17,113,218,39,217,109,118,156,100,119,167,109,118,27,