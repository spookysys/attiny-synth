168,152,118,24,118,155,244,23,105,7,38,201,1,116,88,249,20,54,36,249,20,121,112,162,247,152,199,36,109,215,137,97,19,68,157,52,189,105,116,208,5,134,157,209,17,93,77,154,209,117,218,209,101,23,228,125,218,218,118,101,103,118,119,70,111,30,68,25,68,29,198,73,117,101,156,219,216,52,1,185,45,109,157,100,101,87,87,24,4,125,23,38,73,208,100,71,101,27,39,61,33,65,159,101,16,144,52,125,154,221,6,121,30,103,69,147,217,52,182,109,211,102,27,4,97,211,116,144,102,55,230,121,220,84,70,54,73,216,246,97,71,147,134,113,158,39,125,68,216,198,185,97,116,84,196,105,19,246,105,116,219,180,36,113,18,7,145,93,217,134,77,16,7,153,93,209,