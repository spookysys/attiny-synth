167,230,230,228,84,176,193,54,110,176,189,210,43,189,210,43,189,222,2,54,72,3,158,3,198,44,57,158,3,39,128,189,96,179,75,14,155,143,246,178,228,203,9,236,233,133,13,35,249,184,57,175,57,5,225,5,1,163,13,3,230,20,4,64,145,191,146,191,18,236,96,120,141,57,5,1,3,36,64,17,94,208,178,99,176,3,9,3,36,12,144,48,64,194,120,32,3,36,12,144,48,64,2,151,237,190,6,179,158,236,123,202,44,173,59,39,66,77,50,120,128,47,182,3,99,50,187,185,143,132,252,98,50,75,235,48,230,0,27,206,184,201,131,228,0,147,206,72,11,94,132,15,18,0,179,137,23,4,192,69,2,143,201,14,167,236,87,186,47,57,14,149,3,76,186,83,45,0,196,226,117,8,94,81,206,21,194,96,187,80,39,112,17,32,23,57,14,89,48,149,181,83,1,94,4,0,85,73,93,81,78,69,121,17,5,16,69,1,81,214,69,64,81,21,20,21,