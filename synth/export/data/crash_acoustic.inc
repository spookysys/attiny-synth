0,71,133,73,26,100,85,85,183,85,17,21,25,41,76,119,85,71,100,180,217,25,41,67,28,41,227,55,89,73,56,87,7,81,213,113,102,67,110,144,221,68,21,97,23,97,118,70,250,29,21,89,41,211,77,86,85,85,85,117,220,180,134,209,113,80,69,76,86,209,209,86,231,105,244,121,25,52,230,73,101,69,87,117,84,144,24,118,17,71,149,209,65,214,105,215,73,118,84,85,117,30,16,69,71,75,80,17,65,218,117,80,193,41,198,198,6,17,77,84,17,116,217,17,77,22,69,78,5,24,118,17,244,105,68,84,103,69,23,109,70,68,183,177,89,196,65,101,87,68,68,70,68,68,87,69,69,84,71,84,100,147,71,145,109,20,113,24,17,17,81,29,21,68,81,17,65,22,81,100,117,20,89,145,221,84,27,109,133,93,101,219,69,216,70,100,103,180,93,20,73,84,196,89,55,246,134,209,85,93,69,66,18,29,132,217,81,213,109,68,100,116,135,1,73,87,182,217,77,20,217,97,118,31,84,68,68,68,101,116,85,100,70,69,69,68,87,118,71,100,116,68,68,101,68,68,68,68,52,121,80,217,145,81,93,100,145,213,89,21,109,118,155,221,103,21,65,99,86,52,134,29,65,86,117,86,85,85,117,16,29,68,217,102,119,213,65,21,33,49,101,154,221,103,157,68,29,118,68,70,71,118,101,116,68,68,68,69,71,84,16,16,101,52,89,39,77,21,57,105,71,71,84,70,118,100,71,71,118,68,118,69,118,68,118,145,231,121,80,4,68,21,54,69,154,221,118,209,16,16,118,68,68,68,16,86,84,68,71,84,4,129,113,218,144,68,180,217,77,86,117,118,28,4,105,27,213,65,67,150,109,84,