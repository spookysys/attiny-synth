170,233,233,49,179,45,59,114,163,227,56,54,14,14,110,59,206,186,7,14,224,0,57,56,235,147,14,224,187,1,190,224,7,130,143,126,139,248,2,19,2,0,203,185,0,44,19,8,11,112,133,176,176,19,43,176,59,141,194,50,30,43,35,227,45,184,203,67,130,140,3,21,184,227,92,233,56,0,196,226,224,83,33,14,0,231,2,248,64,165,179,192,54,160,47,67,148,62,2,213,32,11,67,148,192,8,21,197,194,88,21,35,131,71,57,50,64,5,224,82,19,37,3,94,21,82,12,84,22,20,83,132,5,197,85,97,49,5,21,214,94,16,101,13,80,21,5,64,81,81,96,77,69,65,1,69,20,20,80,69,88,83,20,65,89,84,29,80,5,84,68,64,65,68,20,20,69,84,81,88,85,93,5,69,144,81,69,85,116,80,84,85,20,69,100,71,80,68,84,20,85,68,118,81,69,68,84,89,85,85,93,