166,38,38,81,235,190,189,180,143,249,72,110,17,63,154,23,155,215,30,248,14,230,192,64,250,35,96,235,53,35,201,114,77,105,236,94,87,73,56,192,116,80,38,44,3,87,17,160,12,192,64,68,5,34,179,212,68,118,85,137,3,227,84,5,5,85,56,46,227,20,21,80,214,80,0,0,82,20,93,148,151,151,23,82,3,20,69,80,94,94,94,14,148,23,101,85,99,109,81,131,197,5,20,69,22,181,53,148,212,88,67,21,68,1,214,22,53,214,94,80,148,77,57,229,5,88,123,1,69,17,20,0,20,96,237,5,80,20,81,78,1,80,94,14,20,86,29,5,88,91,212,0,20,94,84,17,0,133,23,0,88,3,69,17,5,80,78,1,224,5,80,69,69,129,53,37,53,88,212,69,17,20,5,22,53,214,214,20,69,68,64,89,212,214,22,117,65,85,68,64,89,91,212,20,20,86,85,71,64,89,67,1,5,5,17,21,85,64,1,101,77,65,21,69,86,213,5,148,53,69,81,16,17,17,84,1,5,84,121,4,17,4,81,65,65,1,85,80,5,217,17,81,84,1,84,65,17,65,21,89,85,69,21,85,83,85,86,85,85,85,23,69,81,16,65,68,17,85,69,21,69,65,85,89,85,85,85,85,93,5,85,84,81,85,68,69,86,85,81,85,19,21,17,4,89,209,81,84,81,68,86,85,85,29,84,145,93,84,17,65,84,69,68,84,17,81,69,17,81,85,85,68,21,217,85,69,21,17,21,89,29,21,81,81,68,84,17,17,81,145,29,17,81,69,69,86,85,85,85,85,85,117,84,68,16,21,81,17,17,85,85,85,68,84,21,81,21,81,21,65,84,68,84,4,81,85,21,65,16,68,69,68,4,89,29,85,85,85,69,84,68,84,4,65,16,68,85,85,68,69,68,69,84,85,69,