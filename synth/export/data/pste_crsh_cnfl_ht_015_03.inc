156,24,91,132,182,93,153,221,135,132,125,210,69,16,6,97,87,117,67,18,100,117,148,113,18,221,182,97,68,156,52,65,20,89,29,244,134,97,27,77,210,87,158,70,247,97,54,105,118,219,71,65,30,144,4,65,16,4,113,30,144,4,89,145,221,100,117,148,109,84,102,247,185,97,19,118,69,118,84,85,100,183,109,19,4,113,18,155,182,81,29,196,121,18,7,221,101,152,221,152,132,109,27,221,144,52,164,77,216,132,217,77,28,181,121,210,102,87,19,102,247,225,73,118,116,158,102,119,117,86,54,97,159,246,105,19,118,117,208,24,246,166,109,155,221,155,4,109,183,141,65,216,246,73,75,18,4,65,16,135,221,213,182,132,209,198,49,38,97,16,70,68,117,31,144,39,113,88,217,213,6,65,144,21,109,155,221,147,27,39,65,16,132,109,219,54,97,156,70,247,230,121,158,39,65,156,4,113,158,231,73,28,118,53,73,216,182,109,19,132,217,93,70,117,16,135,29,213,182,145,209,36,65,95,102,69,118,23,65,16,198,105,116,147,29,4,113,214,89,132,81,209,70,69,68,16,68,69,155,157,21,209,77,216,70,85,54,97,116,111,30,144,100,199,134,209,198,113,5,105,155,221,54,77,101,147,4,113,24,77,64,18,102,183,125,24,209,149,25,93,217,149,221,228,65,101,147,4,113,20,36,97,219,102,247,38,65,208,70,27,135,17,221,157,209,149,145,77,210,70,27,102,183,81,29,4,97,118,219,196,73,216,180,93,217,149,17,209,167,149,17,77,18,231,65,69,118,52,73,152,221,54,113,158,183,54,65,216,54,97,219,100,69,144,39,113,26,213,113,218,4,109,87,101,118,84,246,105,119,27,85,217,132,25,93,221,69,24,132,221,177,73,28,147,6,97,68,84,244,105,159,118,85,135,217,77,24,135,132,77,158,180,93,17,198,121,152,221,213,81,198,105,19,70,55,81,4,65,152,221,52,25,153,93,25,93,217,209,135,102,247,65,68,70,84,84,68,52,73,152,221,180,29,65,210,70,144,4,65,16,180,209,132,29,17,209,134,109,155,157,221,54,77,100,52,97,100,116,180,97,118,156,118,117,108,18,4,109,100,119,87,70,116,69,68,101,87,84,54,73,156,102,103,55,77,70,52,73,147,97,144,29,102,183,217,125,16,145,209,228,97,68,87,84,27,132,109,219,68,17,102,71,69,118,31,69,70,87,84,68,182,97,118,19,132,217,109,87,209,144,117,18,102,183,77,27,81,81,17,77,24,77,24,77,154,29,39,209,65,16,7,36,65,16,102,55,77,54,73,86,100,55,113,18,132,217,109,19,132,109,147,213,113,24,81,217,149,81,217,17,93,209,36,89,145,221,4,65,16,102,55,13,73,86,52,77,68,5,121,144,217,77,154,209,132,209,13,73,68,219,4,113,80,217,36,109,180,97,118,219,196,73,16,102,183,109,118,219,132,109,155,221,7,21,164,113,218,167,81,209,213,65,156,135,149,29,149,209,36,65,16,7,145,17,17,77,158,