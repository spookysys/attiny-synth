#ifdef USE_GURO_HTFL_HT_015_03
{
#include "struct/guro_htfl_ht_015_03.inc"
},
#endif
#ifdef USE_GURO_SCFL_HT_015_03
{
#include "struct/guro_scfl_ht_015_03.inc"
},
#endif
#ifdef USE_JK_PRC_03
{
#include "struct/jk_prc_03.inc"
},
#endif
#ifdef USE_JK_PRC_04
{
#include "struct/jk_prc_04.inc"
},
#endif
#ifdef USE_JK_PRC_05
{
#include "struct/jk_prc_05.inc"
},
#endif
#ifdef USE_JK_PRC_06
{
#include "struct/jk_prc_06.inc"
},
#endif
#ifdef USE_JK_PRC_09
{
#include "struct/jk_prc_09.inc"
},
#endif
#ifdef USE_JK_PRC_10
{
#include "struct/jk_prc_10.inc"
},
#endif
#ifdef USE_JK_SNR_01
{
#include "struct/jk_snr_01.inc"
},
#endif
#ifdef USE_JK_SNR_02
{
#include "struct/jk_snr_02.inc"
},
#endif
#ifdef USE_JK_SNR_03
{
#include "struct/jk_snr_03.inc"
},
#endif
#ifdef USE_JK_SNR_04
{
#include "struct/jk_snr_04.inc"
},
#endif
#ifdef USE_JK_SNR_07
{
#include "struct/jk_snr_07.inc"
},
#endif
#ifdef USE_L400_SNR_DCFL_HT_03
{
#include "struct/l400_snr_dcfl_ht_03.inc"
},
#endif
#ifdef USE_L400_SNR_DEFL_HT_03
{
#include "struct/l400_snr_defl_ht_03.inc"
},
#endif
#ifdef USE_L400_SNR_DRFL_HT_03
{
#include "struct/l400_snr_drfl_ht_03.inc"
},
#endif
#ifdef USE_L400_SNR_LCFL_HT_03
{
#include "struct/l400_snr_lcfl_ht_03.inc"
},
#endif
#ifdef USE_L400_SNR_LEFL_HT_03
{
#include "struct/l400_snr_lefl_ht_03.inc"
},
#endif
#ifdef USE_L400_SNR_LRFL_HT_03
{
#include "struct/l400_snr_lrfl_ht_03.inc"
},
#endif
#ifdef USE_L400_SNR_OFFL_HT_03
{
#include "struct/l400_snr_offl_ht_03.inc"
},
#endif
#ifdef USE_L400_SNR_XSFL_HT_03
{
#include "struct/l400_snr_xsfl_ht_03.inc"
},
#endif
#ifdef USE_LWFI_SNR_DCFL_HT_03
{
#include "struct/lwfi_snr_dcfl_ht_03.inc"
},
#endif
#ifdef USE_LWFI_SNR_DEFL_HT_03
{
#include "struct/lwfi_snr_defl_ht_03.inc"
},
#endif
#ifdef USE_LWFI_SNR_DRFL_HT_03
{
#include "struct/lwfi_snr_drfl_ht_03.inc"
},
#endif
#ifdef USE_LWFI_SNR_LCFL_HT_03
{
#include "struct/lwfi_snr_lcfl_ht_03.inc"
},
#endif
#ifdef USE_LWFI_SNR_LEFL_HT_03
{
#include "struct/lwfi_snr_lefl_ht_03.inc"
},
#endif
#ifdef USE_LWFI_SNR_LRFL_HT_03
{
#include "struct/lwfi_snr_lrfl_ht_03.inc"
},
#endif
#ifdef USE_LWFI_SNR_OFFL_HT_03
{
#include "struct/lwfi_snr_offl_ht_03.inc"
},
#endif
#ifdef USE_LWFI_SNR_XSFL_HT_03
{
#include "struct/lwfi_snr_xsfl_ht_03.inc"
},
#endif
#ifdef USE_PSTE_CRSH_CNFL_HT_015_03
{
#include "struct/pste_crsh_cnfl_ht_015_03.inc"
},
#endif
#ifdef USE_PSTE_CRSH_EGFL_HT_015_03
{
#include "struct/pste_crsh_egfl_ht_015_03.inc"
},
#endif
#ifdef USE_PSTE_RIDE_BLFL_HT_03
{
#include "struct/pste_ride_blfl_ht_03.inc"
},
#endif
#ifdef USE_PSTE_RIDE_CNFL_HT_03
{
#include "struct/pste_ride_cnfl_ht_03.inc"
},
#endif
#ifdef USE_PSTE_RIDE_EGFL_HT_03
{
#include "struct/pste_ride_egfl_ht_03.inc"
},
#endif
#ifdef USE_RGRS_FTOM_CNFL_HT_03
{
#include "struct/rgrs_ftom_cnfl_ht_03.inc"
},
#endif
#ifdef USE_RGRS_KICK_HDFL_HT_03
{
#include "struct/rgrs_kick_hdfl_ht_03.inc"
},
#endif
#ifdef USE_RGRS_KICK_SFFL_HT_03
{
#include "struct/rgrs_kick_sffl_ht_03.inc"
},
#endif
#ifdef USE_RGRS_RTOM_CNFL_HT_03
{
#include "struct/rgrs_rtom_cnfl_ht_03.inc"
},
#endif
#ifdef USE_SHKR_HDFL_HT_015_03
{
#include "struct/shkr_hdfl_ht_015_03.inc"
},
#endif
#ifdef USE_SHKR_SFFL_HT_015_03
{
#include "struct/shkr_sffl_ht_015_03.inc"
},
#endif
#ifdef USE_TAMB_HTFL_HT_015_03
{
#include "struct/tamb_htfl_ht_015_03.inc"
},
#endif
#ifdef USE_TAMB_SHFL_HT_015_03
{
#include "struct/tamb_shfl_ht_015_03.inc"
},
#endif
#ifdef USE_ZDJN_HAT_C1EGFL_HT_015_01
{
#include "struct/zdjn_hat_c1egfl_ht_015_01.inc"
},
#endif
#ifdef USE_ZDJN_HAT_C1EGFL_HT_015_02
{
#include "struct/zdjn_hat_c1egfl_ht_015_02.inc"
},
#endif
#ifdef USE_ZDJN_HAT_C1EGFL_HT_015_03
{
#include "struct/zdjn_hat_c1egfl_ht_015_03.inc"
},
#endif
#ifdef USE_ZDJN_HAT_C1FL_HT_015_01
{
#include "struct/zdjn_hat_c1fl_ht_015_01.inc"
},
#endif
#ifdef USE_ZDJN_HAT_C1FL_HT_015_02
{
#include "struct/zdjn_hat_c1fl_ht_015_02.inc"
},
#endif
#ifdef USE_ZDJN_HAT_C1FL_HT_015_03
{
#include "struct/zdjn_hat_c1fl_ht_015_03.inc"
},
#endif
#ifdef USE_ZDJN_HAT_C2EGFL_HT_015_01
{
#include "struct/zdjn_hat_c2egfl_ht_015_01.inc"
},
#endif
#ifdef USE_ZDJN_HAT_C2EGFL_HT_015_02
{
#include "struct/zdjn_hat_c2egfl_ht_015_02.inc"
},
#endif
#ifdef USE_ZDJN_HAT_C2EGFL_HT_015_03
{
#include "struct/zdjn_hat_c2egfl_ht_015_03.inc"
},
#endif
#ifdef USE_ZDJN_HAT_C2FL_HT_015_01
{
#include "struct/zdjn_hat_c2fl_ht_015_01.inc"
},
#endif
#ifdef USE_ZDJN_HAT_C2FL_HT_015_02
{
#include "struct/zdjn_hat_c2fl_ht_015_02.inc"
},
#endif
#ifdef USE_ZDJN_HAT_C2FL_HT_015_03
{
#include "struct/zdjn_hat_c2fl_ht_015_03.inc"
},
#endif
#ifdef USE_ZDJN_HAT_C3EGFL_HT_015_03
{
#include "struct/zdjn_hat_c3egfl_ht_015_03.inc"
},
#endif
#ifdef USE_ZDJN_HAT_C3FL_HT_015_03
{
#include "struct/zdjn_hat_c3fl_ht_015_03.inc"
},
#endif
#ifdef USE_ZDJN_HAT_O1EGFL_HT_015_03
{
#include "struct/zdjn_hat_o1egfl_ht_015_03.inc"
},
#endif
#ifdef USE_ZDJN_HAT_O1FL_HT_015_03
{
#include "struct/zdjn_hat_o1fl_ht_015_03.inc"
},
#endif
#ifdef USE_ZDJN_HAT_O2EGFL_HT_015_03
{
#include "struct/zdjn_hat_o2egfl_ht_015_03.inc"
},
#endif
#ifdef USE_ZDJN_HAT_O2FL_HT_015_03
{
#include "struct/zdjn_hat_o2fl_ht_015_03.inc"
},
#endif
#ifdef USE_ZDJN_HAT_O3EGFL_HT_015_03
{
#include "struct/zdjn_hat_o3egfl_ht_015_03.inc"
},
#endif
#ifdef USE_ZDJN_HAT_O3FL_HT_015_03
{
#include "struct/zdjn_hat_o3fl_ht_015_03.inc"
},
#endif
#ifdef USE_ZDJN_HAT_POFL_HT_015_03
{
#include "struct/zdjn_hat_pofl_ht_015_03.inc"
},
#endif
#ifdef USE_ZDJN_HAT_PSFL_HT_015_01
{
#include "struct/zdjn_hat_psfl_ht_015_01.inc"
},
#endif
#ifdef USE_ZDJN_HAT_PSFL_HT_015_02
{
#include "struct/zdjn_hat_psfl_ht_015_02.inc"
},
#endif
#ifdef USE_ZDJN_HAT_PSFL_HT_015_03
{
#include "struct/zdjn_hat_psfl_ht_015_03.inc"
},
#endif
#ifdef USE_AMEN_01
{
#include "struct/amen_01.inc"
},
#endif
#ifdef USE_AMEN_02
{
#include "struct/amen_02.inc"
},
#endif
#ifdef USE_AMEN_03
{
#include "struct/amen_03.inc"
},
#endif
#ifdef USE_AMEN_04
{
#include "struct/amen_04.inc"
},
#endif
#ifdef USE_AMEN_05
{
#include "struct/amen_05.inc"
},
#endif
#ifdef USE_AMEN_06
{
#include "struct/amen_06.inc"
},
#endif
#ifdef USE_AMEN_07
{
#include "struct/amen_07.inc"
},
#endif
#ifdef USE_AMEN_08
{
#include "struct/amen_08.inc"
},
#endif
#ifdef USE_AMEN_09
{
#include "struct/amen_09.inc"
},
#endif
#ifdef USE_AMEN_10
{
#include "struct/amen_10.inc"
},
#endif
#ifdef USE_AMEN_11
{
#include "struct/amen_11.inc"
},
#endif
#ifdef USE_AMEN_12
{
#include "struct/amen_12.inc"
},
#endif
#ifdef USE_AMEN_13
{
#include "struct/amen_13.inc"
},
#endif
#ifdef USE_AMEN_14
{
#include "struct/amen_14.inc"
},
#endif
#ifdef USE_AMEN_15
{
#include "struct/amen_15.inc"
},
#endif
#ifdef USE_AMEN_16
{
#include "struct/amen_16.inc"
},
#endif
#ifdef USE_AMEN_17
{
#include "struct/amen_17.inc"
},
#endif
#ifdef USE_AMEN_18
{
#include "struct/amen_18.inc"
},
#endif
#ifdef USE_AMEN_19
{
#include "struct/amen_19.inc"
},
#endif
#ifdef USE_AMEN_20
{
#include "struct/amen_20.inc"
},
#endif
#ifdef USE_AMEN_21
{
#include "struct/amen_21.inc"
},
#endif
#ifdef USE_AMEN_22
{
#include "struct/amen_22.inc"
},
#endif
#ifdef USE_AMEN_23
{
#include "struct/amen_23.inc"
},
#endif
#ifdef USE_AMEN_24
{
#include "struct/amen_24.inc"
},
#endif
#ifdef USE_AMEN_25
{
#include "struct/amen_25.inc"
},
#endif
#ifdef USE_AMEN_26
{
#include "struct/amen_26.inc"
},
#endif
#ifdef USE_AMEN_27
{
#include "struct/amen_27.inc"
},
#endif
#ifdef USE_AMEN_28
{
#include "struct/amen_28.inc"
},
#endif
#ifdef USE_AMEN_29
{
#include "struct/amen_29.inc"
},
#endif
#ifdef USE_AMEN_30
{
#include "struct/amen_30.inc"
},
#endif
#ifdef USE_AMEN_31
{
#include "struct/amen_31.inc"
},
#endif
#ifdef USE_AMEN_32
{
#include "struct/amen_32.inc"
},
#endif
#ifdef USE_AMEN_33
{
#include "struct/amen_33.inc"
},
#endif
#ifdef USE_AMEN_34
{
#include "struct/amen_34.inc"
},
#endif
#ifdef USE_AMEN_35
{
#include "struct/amen_35.inc"
},
#endif
#ifdef USE_AMEN_36
{
#include "struct/amen_36.inc"
},
#endif
#ifdef USE_AMEN_37
{
#include "struct/amen_37.inc"
},
#endif
#ifdef USE_AMEN_38
{
#include "struct/amen_38.inc"
},
#endif
#ifdef USE_AMEN_39
{
#include "struct/amen_39.inc"
},
#endif
#ifdef USE_AMEN_40
{
#include "struct/amen_40.inc"
},
#endif
#ifdef USE_AMEN_41
{
#include "struct/amen_41.inc"
},
#endif
#ifdef USE_AMEN_42
{
#include "struct/amen_42.inc"
},
#endif
#ifdef USE_AMEN_43
{
#include "struct/amen_43.inc"
},
#endif
#ifdef USE_AMEN_44
{
#include "struct/amen_44.inc"
},
#endif
#ifdef USE_AMEN_45
{
#include "struct/amen_45.inc"
},
#endif
#ifdef USE_AMEN_46
{
#include "struct/amen_46.inc"
},
#endif
#ifdef USE_CLAP_808
{
#include "struct/clap_808.inc"
},
#endif
#ifdef USE_CLAP_ANALOG
{
#include "struct/clap_analog.inc"
},
#endif
#ifdef USE_CLAP_CRUSHED
{
#include "struct/clap_crushed.inc"
},
#endif
#ifdef USE_CLAP_FAT
{
#include "struct/clap_fat.inc"
},
#endif
#ifdef USE_CLAP_SLAPPER
{
#include "struct/clap_slapper.inc"
},
#endif
#ifdef USE_CLAP_TAPE
{
#include "struct/clap_tape.inc"
},
#endif
#ifdef USE_COWBELL_808
{
#include "struct/cowbell_808.inc"
},
#endif
#ifdef USE_CRASH_808
{
#include "struct/crash_808.inc"
},
#endif
#ifdef USE_CRASH_ACOUSTIC
{
#include "struct/crash_acoustic.inc"
},
#endif
#ifdef USE_CRASH_NOISE
{
#include "struct/crash_noise.inc"
},
#endif
#ifdef USE_CRASH_TAPE
{
#include "struct/crash_tape.inc"
},
#endif
#ifdef USE_HIHAT_808
{
#include "struct/hihat_808.inc"
},
#endif
#ifdef USE_HIHAT_ACOUSTIC01
{
#include "struct/hihat_acoustic01.inc"
},
#endif
#ifdef USE_HIHAT_ACOUSTIC02
{
#include "struct/hihat_acoustic02.inc"
},
#endif
#ifdef USE_HIHAT_ANALOG
{
#include "struct/hihat_analog.inc"
},
#endif
#ifdef USE_HIHAT_DIGITAL
{
#include "struct/hihat_digital.inc"
},
#endif
#ifdef USE_HIHAT_DIST01
{
#include "struct/hihat_dist01.inc"
},
#endif
#ifdef USE_HIHAT_DIST02
{
#include "struct/hihat_dist02.inc"
},
#endif
#ifdef USE_HIHAT_ELECTRO
{
#include "struct/hihat_electro.inc"
},
#endif
#ifdef USE_HIHAT_PLAIN
{
#include "struct/hihat_plain.inc"
},
#endif
#ifdef USE_HIHAT_RESO
{
#include "struct/hihat_reso.inc"
},
#endif
#ifdef USE_HIHAT_RING
{
#include "struct/hihat_ring.inc"
},
#endif
#ifdef USE_KICK_808
{
#include "struct/kick_808.inc"
},
#endif
#ifdef USE_KICK_ACOUSTIC01
{
#include "struct/kick_acoustic01.inc"
},
#endif
#ifdef USE_KICK_ACOUSTIC02
{
#include "struct/kick_acoustic02.inc"
},
#endif
#ifdef USE_KICK_BIG
{
#include "struct/kick_big.inc"
},
#endif
#ifdef USE_KICK_CLASSIC
{
#include "struct/kick_classic.inc"
},
#endif
#ifdef USE_KICK_CULTIVATOR
{
#include "struct/kick_cultivator.inc"
},
#endif
#ifdef USE_KICK_DEEP
{
#include "struct/kick_deep.inc"
},
#endif
#ifdef USE_KICK_DRY
{
#include "struct/kick_dry.inc"
},
#endif
#ifdef USE_KICK_ELECTRO01
{
#include "struct/kick_electro01.inc"
},
#endif
#ifdef USE_KICK_ELECTRO02
{
#include "struct/kick_electro02.inc"
},
#endif
#ifdef USE_KICK_FLOPPY
{
#include "struct/kick_floppy.inc"
},
#endif
#ifdef USE_KICK_GRITTY
{
#include "struct/kick_gritty.inc"
},
#endif
#ifdef USE_KICK_HEAVY
{
#include "struct/kick_heavy.inc"
},
#endif
#ifdef USE_KICK_NEWWAVE
{
#include "struct/kick_newwave.inc"
},
#endif
#ifdef USE_KICK_OLDSCHOOL
{
#include "struct/kick_oldschool.inc"
},
#endif
#ifdef USE_KICK_PLAIN
{
#include "struct/kick_plain.inc"
},
#endif
#ifdef USE_KICK_SLAPBACK
{
#include "struct/kick_slapback.inc"
},
#endif
#ifdef USE_KICK_SOFTY
{
#include "struct/kick_softy.inc"
},
#endif
#ifdef USE_KICK_STOMP
{
#include "struct/kick_stomp.inc"
},
#endif
#ifdef USE_KICK_TAPE
{
#include "struct/kick_tape.inc"
},
#endif
#ifdef USE_KICK_THUMP
{
#include "struct/kick_thump.inc"
},
#endif
#ifdef USE_KICK_TIGHT
{
#include "struct/kick_tight.inc"
},
#endif
#ifdef USE_KICK_TRON
{
#include "struct/kick_tron.inc"
},
#endif
#ifdef USE_KICK_VINYL01
{
#include "struct/kick_vinyl01.inc"
},
#endif
#ifdef USE_KICK_VINYL02
{
#include "struct/kick_vinyl02.inc"
},
#endif
#ifdef USE_KICK_ZAPPER
{
#include "struct/kick_zapper.inc"
},
#endif
#ifdef USE_OPENHAT_808
{
#include "struct/openhat_808.inc"
},
#endif
#ifdef USE_OPENHAT_ACOUSTIC01
{
#include "struct/openhat_acoustic01.inc"
},
#endif
#ifdef USE_OPENHAT_ANALOG
{
#include "struct/openhat_analog.inc"
},
#endif
#ifdef USE_OPENHAT_SLICK
{
#include "struct/openhat_slick.inc"
},
#endif
#ifdef USE_OPENHAT_TIGHT
{
#include "struct/openhat_tight.inc"
},
#endif
#ifdef USE_PERC_808
{
#include "struct/perc_808.inc"
},
#endif
#ifdef USE_PERC_CHIRPY
{
#include "struct/perc_chirpy.inc"
},
#endif
#ifdef USE_PERC_HOLLOW
{
#include "struct/perc_hollow.inc"
},
#endif
#ifdef USE_PERC_LASER
{
#include "struct/perc_laser.inc"
},
#endif
#ifdef USE_PERC_METAL
{
#include "struct/perc_metal.inc"
},
#endif
#ifdef USE_PERC_NASTY
{
#include "struct/perc_nasty.inc"
},
#endif
#ifdef USE_PERC_SHORT
{
#include "struct/perc_short.inc"
},
#endif
#ifdef USE_PERC_TAMBO
{
#include "struct/perc_tambo.inc"
},
#endif
#ifdef USE_PERC_TRIBAL
{
#include "struct/perc_tribal.inc"
},
#endif
#ifdef USE_PERC_WEIRDO
{
#include "struct/perc_weirdo.inc"
},
#endif
#ifdef USE_RIDE_ACOUSTIC01
{
#include "struct/ride_acoustic01.inc"
},
#endif
#ifdef USE_RIDE_ACOUSTIC02
{
#include "struct/ride_acoustic02.inc"
},
#endif
#ifdef USE_SHAKER_ANALOG
{
#include "struct/shaker_analog.inc"
},
#endif
#ifdef USE_SHAKER_SHUFFLE
{
#include "struct/shaker_shuffle.inc"
},
#endif
#ifdef USE_SHAKER_SUCKUP
{
#include "struct/shaker_suckup.inc"
},
#endif
#ifdef USE_SNARE_808
{
#include "struct/snare_808.inc"
},
#endif
#ifdef USE_SNARE_ACOUSTIC01
{
#include "struct/snare_acoustic01.inc"
},
#endif
#ifdef USE_SNARE_ACOUSTIC02
{
#include "struct/snare_acoustic02.inc"
},
#endif
#ifdef USE_SNARE_ANALOG
{
#include "struct/snare_analog.inc"
},
#endif
#ifdef USE_SNARE_BIG
{
#include "struct/snare_big.inc"
},
#endif
#ifdef USE_SNARE_BLOCK
{
#include "struct/snare_block.inc"
},
#endif
#ifdef USE_SNARE_BRUTE
{
#include "struct/snare_brute.inc"
},
#endif
#ifdef USE_SNARE_DIST01
{
#include "struct/snare_dist01.inc"
},
#endif
#ifdef USE_SNARE_DIST02
{
#include "struct/snare_dist02.inc"
},
#endif
#ifdef USE_SNARE_DIST03
{
#include "struct/snare_dist03.inc"
},
#endif
#ifdef USE_SNARE_ELECTRO
{
#include "struct/snare_electro.inc"
},
#endif
#ifdef USE_SNARE_LOFI01
{
#include "struct/snare_lofi01.inc"
},
#endif
#ifdef USE_SNARE_LOFI02
{
#include "struct/snare_lofi02.inc"
},
#endif
#ifdef USE_SNARE_MODULAR
{
#include "struct/snare_modular.inc"
},
#endif
#ifdef USE_SNARE_NOISE
{
#include "struct/snare_noise.inc"
},
#endif
#ifdef USE_SNARE_PINCH
{
#include "struct/snare_pinch.inc"
},
#endif
#ifdef USE_SNARE_PUNCH
{
#include "struct/snare_punch.inc"
},
#endif
#ifdef USE_SNARE_SMASHER
{
#include "struct/snare_smasher.inc"
},
#endif
#ifdef USE_SNARE_SUMO
{
#include "struct/snare_sumo.inc"
},
#endif
#ifdef USE_SNARE_TAPE
{
#include "struct/snare_tape.inc"
},
#endif
#ifdef USE_SNARE_VINYL01
{
#include "struct/snare_vinyl01.inc"
},
#endif
#ifdef USE_SNARE_VINYL02
{
#include "struct/snare_vinyl02.inc"
},
#endif
#ifdef USE_TOM_808
{
#include "struct/tom_808.inc"
},
#endif
#ifdef USE_TOM_ACOUSTIC01
{
#include "struct/tom_acoustic01.inc"
},
#endif
#ifdef USE_TOM_ACOUSTIC02
{
#include "struct/tom_acoustic02.inc"
},
#endif
#ifdef USE_TOM_ANALOG
{
#include "struct/tom_analog.inc"
},
#endif
#ifdef USE_TOM_CHIPTUNE
{
#include "struct/tom_chiptune.inc"
},
#endif
#ifdef USE_TOM_FM
{
#include "struct/tom_fm.inc"
},
#endif
#ifdef USE_TOM_LOFI
{
#include "struct/tom_lofi.inc"
},
#endif
#ifdef USE_TOM_ROTOTOM
{
#include "struct/tom_rototom.inc"
},
#endif
#ifdef USE_TOM_SHORT
{
#include "struct/tom_short.inc"
},
#endif
