"guro_htfl_ht_015_03",
"guro_scfl_ht_015_03",
"jk_prc_03",
"jk_prc_04",
"jk_prc_05",
"jk_prc_06",
"jk_prc_09",
"jk_prc_10",
"jk_snr_01",
"jk_snr_02",
"jk_snr_03",
"jk_snr_04",
"jk_snr_07",
"l400_snr_dcfl_ht_03",
"l400_snr_defl_ht_03",
"l400_snr_drfl_ht_03",
"l400_snr_lcfl_ht_03",
"l400_snr_lefl_ht_03",
"l400_snr_lrfl_ht_03",
"l400_snr_offl_ht_03",
"l400_snr_xsfl_ht_03",
"lwfi_snr_dcfl_ht_03",
"lwfi_snr_defl_ht_03",
"lwfi_snr_drfl_ht_03",
"lwfi_snr_lcfl_ht_03",
"lwfi_snr_lefl_ht_03",
"lwfi_snr_lrfl_ht_03",
"lwfi_snr_offl_ht_03",
"lwfi_snr_xsfl_ht_03",
"pste_crsh_cnfl_ht_015_03",
"pste_crsh_egfl_ht_015_03",
"pste_ride_blfl_ht_03",
"pste_ride_cnfl_ht_03",
"pste_ride_egfl_ht_03",
"rgrs_ftom_cnfl_ht_03",
"rgrs_kick_hdfl_ht_03",
"rgrs_kick_sffl_ht_03",
"rgrs_rtom_cnfl_ht_03",
"shkr_hdfl_ht_015_03",
"shkr_sffl_ht_015_03",
"tamb_htfl_ht_015_03",
"tamb_shfl_ht_015_03",
"zdjn_hat_c1egfl_ht_015_01",
"zdjn_hat_c1egfl_ht_015_02",
"zdjn_hat_c1egfl_ht_015_03",
"zdjn_hat_c1fl_ht_015_01",
"zdjn_hat_c1fl_ht_015_02",
"zdjn_hat_c1fl_ht_015_03",
"zdjn_hat_c2egfl_ht_015_01",
"zdjn_hat_c2egfl_ht_015_02",
"zdjn_hat_c2egfl_ht_015_03",
"zdjn_hat_c2fl_ht_015_01",
"zdjn_hat_c2fl_ht_015_02",
"zdjn_hat_c2fl_ht_015_03",
"zdjn_hat_c3egfl_ht_015_03",
"zdjn_hat_c3fl_ht_015_03",
"zdjn_hat_o1egfl_ht_015_03",
"zdjn_hat_o1fl_ht_015_03",
"zdjn_hat_o2egfl_ht_015_03",
"zdjn_hat_o2fl_ht_015_03",
"zdjn_hat_o3egfl_ht_015_03",
"zdjn_hat_o3fl_ht_015_03",
"zdjn_hat_pofl_ht_015_03",
"zdjn_hat_psfl_ht_015_01",
"zdjn_hat_psfl_ht_015_02",
"zdjn_hat_psfl_ht_015_03",
"amen_01",
"amen_02",
"amen_03",
"amen_04",
"amen_05",
"amen_06",
"amen_07",
"amen_08",
"amen_09",
"amen_10",
"amen_11",
"amen_12",
"amen_13",
"amen_14",
"amen_15",
"amen_16",
"amen_17",
"amen_18",
"amen_19",
"amen_20",
"amen_21",
"amen_22",
"amen_23",
"amen_24",
"amen_25",
"amen_26",
"amen_27",
"amen_28",
"amen_29",
"amen_30",
"amen_31",
"amen_32",
"amen_33",
"amen_34",
"amen_35",
"amen_36",
"amen_37",
"amen_38",
"amen_39",
"amen_40",
"amen_41",
"amen_42",
"amen_43",
"amen_44",
"amen_45",
"amen_46",
"clap_808",
"clap_analog",
"clap_crushed",
"clap_fat",
"clap_slapper",
"clap_tape",
"cowbell_808",
"crash_808",
"crash_acoustic",
"crash_noise",
"crash_tape",
"hihat_808",
"hihat_acoustic01",
"hihat_acoustic02",
"hihat_analog",
"hihat_digital",
"hihat_dist01",
"hihat_dist02",
"hihat_electro",
"hihat_plain",
"hihat_reso",
"hihat_ring",
"kick_808",
"kick_acoustic01",
"kick_acoustic02",
"kick_big",
"kick_classic",
"kick_cultivator",
"kick_deep",
"kick_dry",
"kick_electro01",
"kick_electro02",
"kick_floppy",
"kick_gritty",
"kick_heavy",
"kick_newwave",
"kick_oldschool",
"kick_plain",
"kick_slapback",
"kick_softy",
"kick_stomp",
"kick_tape",
"kick_thump",
"kick_tight",
"kick_tron",
"kick_vinyl01",
"kick_vinyl02",
"kick_zapper",
"openhat_808",
"openhat_acoustic01",
"openhat_analog",
"openhat_slick",
"openhat_tight",
"perc_808",
"perc_chirpy",
"perc_hollow",
"perc_laser",
"perc_metal",
"perc_nasty",
"perc_short",
"perc_tambo",
"perc_tribal",
"perc_weirdo",
"ride_acoustic01",
"ride_acoustic02",
"shaker_analog",
"shaker_shuffle",
"shaker_suckup",
"snare_808",
"snare_acoustic01",
"snare_acoustic02",
"snare_analog",
"snare_big",
"snare_block",
"snare_brute",
"snare_dist01",
"snare_dist02",
"snare_dist03",
"snare_electro",
"snare_lofi01",
"snare_lofi02",
"snare_modular",
"snare_noise",
"snare_pinch",
"snare_punch",
"snare_smasher",
"snare_sumo",
"snare_tape",
"snare_vinyl01",
"snare_vinyl02",
"tom_808",
"tom_acoustic01",
"tom_acoustic02",
"tom_analog",
"tom_chiptune",
"tom_fm",
"tom_lofi",
"tom_rototom",
"tom_short",
