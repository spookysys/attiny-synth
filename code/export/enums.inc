#ifdef USE_AMEN_BDHH_2
AMEN_BDHH_2,
#endif
#ifdef USE_AMEN_BDHH_3
AMEN_BDHH_3,
#endif
#ifdef USE_AMEN_BDHH_4
AMEN_BDHH_4,
#endif
#ifdef USE_AMEN_BDHH_5
AMEN_BDHH_5,
#endif
#ifdef USE_AMEN_BDHH
AMEN_BDHH,
#endif
#ifdef USE_AMEN_BDHHSOFT_2
AMEN_BDHHSOFT_2,
#endif
#ifdef USE_AMEN_BDHHSOFT_3
AMEN_BDHHSOFT_3,
#endif
#ifdef USE_AMEN_BDHHSOFT
AMEN_BDHHSOFT,
#endif
#ifdef USE_AMEN_BDSOFT_2
AMEN_BDSOFT_2,
#endif
#ifdef USE_AMEN_BDSOFT_3
AMEN_BDSOFT_3,
#endif
#ifdef USE_AMEN_BDSOFT
AMEN_BDSOFT,
#endif
#ifdef USE_AMEN_CRASHBD
AMEN_CRASHBD,
#endif
#ifdef USE_AMEN_HH_10
AMEN_HH_10,
#endif
#ifdef USE_AMEN_HH_11
AMEN_HH_11,
#endif
#ifdef USE_AMEN_HH_2
AMEN_HH_2,
#endif
#ifdef USE_AMEN_HH_3
AMEN_HH_3,
#endif
#ifdef USE_AMEN_HH_4
AMEN_HH_4,
#endif
#ifdef USE_AMEN_HH_5
AMEN_HH_5,
#endif
#ifdef USE_AMEN_HH_6
AMEN_HH_6,
#endif
#ifdef USE_AMEN_HH_7
AMEN_HH_7,
#endif
#ifdef USE_AMEN_HH_8
AMEN_HH_8,
#endif
#ifdef USE_AMEN_HH_9
AMEN_HH_9,
#endif
#ifdef USE_AMEN_HH
AMEN_HH,
#endif
#ifdef USE_AMEN_HIT
AMEN_HIT,
#endif
#ifdef USE_AMEN_LOUDBDHH
AMEN_LOUDBDHH,
#endif
#ifdef USE_AMEN_RIDE
AMEN_RIDE,
#endif
#ifdef USE_AMEN_SNARE_2
AMEN_SNARE_2,
#endif
#ifdef USE_AMEN_SNARE_3
AMEN_SNARE_3,
#endif
#ifdef USE_AMEN_SNARE_4
AMEN_SNARE_4,
#endif
#ifdef USE_AMEN_SNARE_5
AMEN_SNARE_5,
#endif
#ifdef USE_AMEN_SNARE_6
AMEN_SNARE_6,
#endif
#ifdef USE_AMEN_SNARE
AMEN_SNARE,
#endif
#ifdef USE_AMEN_SNAREHARD
AMEN_SNAREHARD,
#endif
#ifdef USE_AMEN_SNAREHISS
AMEN_SNAREHISS,
#endif
#ifdef USE_AMEN_SOFTSNARE_10
AMEN_SOFTSNARE_10,
#endif
#ifdef USE_AMEN_SOFTSNARE_11
AMEN_SOFTSNARE_11,
#endif
#ifdef USE_AMEN_SOFTSNARE_2
AMEN_SOFTSNARE_2,
#endif
#ifdef USE_AMEN_SOFTSNARE_3
AMEN_SOFTSNARE_3,
#endif
#ifdef USE_AMEN_SOFTSNARE_4
AMEN_SOFTSNARE_4,
#endif
#ifdef USE_AMEN_SOFTSNARE_5
AMEN_SOFTSNARE_5,
#endif
#ifdef USE_AMEN_SOFTSNARE_6
AMEN_SOFTSNARE_6,
#endif
#ifdef USE_AMEN_SOFTSNARE_7
AMEN_SOFTSNARE_7,
#endif
#ifdef USE_AMEN_SOFTSNARE_8
AMEN_SOFTSNARE_8,
#endif
#ifdef USE_AMEN_SOFTSNARE_9
AMEN_SOFTSNARE_9,
#endif
#ifdef USE_AMEN_SOFTSNARE
AMEN_SOFTSNARE,
#endif
#ifdef USE_GURO_HTFL_HT_015_03
GURO_HTFL_HT_015_03,
#endif
#ifdef USE_GURO_SCFL_HT_015_03
GURO_SCFL_HT_015_03,
#endif
#ifdef USE_JK_PRC_03
JK_PRC_03,
#endif
#ifdef USE_JK_PRC_04
JK_PRC_04,
#endif
#ifdef USE_JK_PRC_05
JK_PRC_05,
#endif
#ifdef USE_JK_PRC_06
JK_PRC_06,
#endif
#ifdef USE_JK_PRC_09
JK_PRC_09,
#endif
#ifdef USE_JK_PRC_10
JK_PRC_10,
#endif
#ifdef USE_JK_SNR_01
JK_SNR_01,
#endif
#ifdef USE_JK_SNR_02
JK_SNR_02,
#endif
#ifdef USE_JK_SNR_03
JK_SNR_03,
#endif
#ifdef USE_JK_SNR_04
JK_SNR_04,
#endif
#ifdef USE_JK_SNR_07
JK_SNR_07,
#endif
#ifdef USE_L400_SNR_DCFL_HT_03
L400_SNR_DCFL_HT_03,
#endif
#ifdef USE_L400_SNR_DEFL_HT_03
L400_SNR_DEFL_HT_03,
#endif
#ifdef USE_L400_SNR_DRFL_HT_03
L400_SNR_DRFL_HT_03,
#endif
#ifdef USE_L400_SNR_LCFL_HT_03
L400_SNR_LCFL_HT_03,
#endif
#ifdef USE_L400_SNR_LEFL_HT_03
L400_SNR_LEFL_HT_03,
#endif
#ifdef USE_L400_SNR_LRFL_HT_03
L400_SNR_LRFL_HT_03,
#endif
#ifdef USE_L400_SNR_OFFL_HT_03
L400_SNR_OFFL_HT_03,
#endif
#ifdef USE_L400_SNR_XSFL_HT_03
L400_SNR_XSFL_HT_03,
#endif
#ifdef USE_LWFI_SNR_DCFL_HT_03
LWFI_SNR_DCFL_HT_03,
#endif
#ifdef USE_LWFI_SNR_DEFL_HT_03
LWFI_SNR_DEFL_HT_03,
#endif
#ifdef USE_LWFI_SNR_DRFL_HT_03
LWFI_SNR_DRFL_HT_03,
#endif
#ifdef USE_LWFI_SNR_LCFL_HT_03
LWFI_SNR_LCFL_HT_03,
#endif
#ifdef USE_LWFI_SNR_LEFL_HT_03
LWFI_SNR_LEFL_HT_03,
#endif
#ifdef USE_LWFI_SNR_LRFL_HT_03
LWFI_SNR_LRFL_HT_03,
#endif
#ifdef USE_LWFI_SNR_OFFL_HT_03
LWFI_SNR_OFFL_HT_03,
#endif
#ifdef USE_LWFI_SNR_XSFL_HT_03
LWFI_SNR_XSFL_HT_03,
#endif
#ifdef USE_PSTE_CRSH_CNFL_HT_015_03
PSTE_CRSH_CNFL_HT_015_03,
#endif
#ifdef USE_PSTE_CRSH_EGFL_HT_015_03
PSTE_CRSH_EGFL_HT_015_03,
#endif
#ifdef USE_PSTE_RIDE_BLFL_HT_03
PSTE_RIDE_BLFL_HT_03,
#endif
#ifdef USE_PSTE_RIDE_CNFL_HT_03
PSTE_RIDE_CNFL_HT_03,
#endif
#ifdef USE_PSTE_RIDE_EGFL_HT_03
PSTE_RIDE_EGFL_HT_03,
#endif
#ifdef USE_RGRS_FTOM_CNFL_HT_03
RGRS_FTOM_CNFL_HT_03,
#endif
#ifdef USE_RGRS_KICK_HDFL_HT_03
RGRS_KICK_HDFL_HT_03,
#endif
#ifdef USE_RGRS_KICK_SFFL_HT_03
RGRS_KICK_SFFL_HT_03,
#endif
#ifdef USE_RGRS_RTOM_CNFL_HT_03
RGRS_RTOM_CNFL_HT_03,
#endif
#ifdef USE_SHKR_HDFL_HT_015_03
SHKR_HDFL_HT_015_03,
#endif
#ifdef USE_SHKR_SFFL_HT_015_03
SHKR_SFFL_HT_015_03,
#endif
#ifdef USE_TAMB_HTFL_HT_015_03
TAMB_HTFL_HT_015_03,
#endif
#ifdef USE_TAMB_SHFL_HT_015_03
TAMB_SHFL_HT_015_03,
#endif
#ifdef USE_ZDJN_HAT_C1EGFL_HT_015_01
ZDJN_HAT_C1EGFL_HT_015_01,
#endif
#ifdef USE_ZDJN_HAT_C1EGFL_HT_015_02
ZDJN_HAT_C1EGFL_HT_015_02,
#endif
#ifdef USE_ZDJN_HAT_C1EGFL_HT_015_03
ZDJN_HAT_C1EGFL_HT_015_03,
#endif
#ifdef USE_ZDJN_HAT_C1FL_HT_015_01
ZDJN_HAT_C1FL_HT_015_01,
#endif
#ifdef USE_ZDJN_HAT_C1FL_HT_015_02
ZDJN_HAT_C1FL_HT_015_02,
#endif
#ifdef USE_ZDJN_HAT_C1FL_HT_015_03
ZDJN_HAT_C1FL_HT_015_03,
#endif
#ifdef USE_ZDJN_HAT_C2EGFL_HT_015_01
ZDJN_HAT_C2EGFL_HT_015_01,
#endif
#ifdef USE_ZDJN_HAT_C2EGFL_HT_015_02
ZDJN_HAT_C2EGFL_HT_015_02,
#endif
#ifdef USE_ZDJN_HAT_C2EGFL_HT_015_03
ZDJN_HAT_C2EGFL_HT_015_03,
#endif
#ifdef USE_ZDJN_HAT_C2FL_HT_015_01
ZDJN_HAT_C2FL_HT_015_01,
#endif
#ifdef USE_ZDJN_HAT_C2FL_HT_015_02
ZDJN_HAT_C2FL_HT_015_02,
#endif
#ifdef USE_ZDJN_HAT_C2FL_HT_015_03
ZDJN_HAT_C2FL_HT_015_03,
#endif
#ifdef USE_ZDJN_HAT_C3EGFL_HT_015_03
ZDJN_HAT_C3EGFL_HT_015_03,
#endif
#ifdef USE_ZDJN_HAT_C3FL_HT_015_03
ZDJN_HAT_C3FL_HT_015_03,
#endif
#ifdef USE_ZDJN_HAT_O1EGFL_HT_015_03
ZDJN_HAT_O1EGFL_HT_015_03,
#endif
#ifdef USE_ZDJN_HAT_O1FL_HT_015_03
ZDJN_HAT_O1FL_HT_015_03,
#endif
#ifdef USE_ZDJN_HAT_O2EGFL_HT_015_03
ZDJN_HAT_O2EGFL_HT_015_03,
#endif
#ifdef USE_ZDJN_HAT_O2FL_HT_015_03
ZDJN_HAT_O2FL_HT_015_03,
#endif
#ifdef USE_ZDJN_HAT_O3EGFL_HT_015_03
ZDJN_HAT_O3EGFL_HT_015_03,
#endif
#ifdef USE_ZDJN_HAT_O3FL_HT_015_03
ZDJN_HAT_O3FL_HT_015_03,
#endif
#ifdef USE_ZDJN_HAT_POFL_HT_015_03
ZDJN_HAT_POFL_HT_015_03,
#endif
#ifdef USE_ZDJN_HAT_PSFL_HT_015_01
ZDJN_HAT_PSFL_HT_015_01,
#endif
#ifdef USE_ZDJN_HAT_PSFL_HT_015_02
ZDJN_HAT_PSFL_HT_015_02,
#endif
#ifdef USE_ZDJN_HAT_PSFL_HT_015_03
ZDJN_HAT_PSFL_HT_015_03,
#endif
#ifdef USE_CLAP_808
CLAP_808,
#endif
#ifdef USE_CLAP_ANALOG
CLAP_ANALOG,
#endif
#ifdef USE_CLAP_CRUSHED
CLAP_CRUSHED,
#endif
#ifdef USE_CLAP_FAT
CLAP_FAT,
#endif
#ifdef USE_CLAP_SLAPPER
CLAP_SLAPPER,
#endif
#ifdef USE_CLAP_TAPE
CLAP_TAPE,
#endif
#ifdef USE_COWBELL_808
COWBELL_808,
#endif
#ifdef USE_CRASH_808
CRASH_808,
#endif
#ifdef USE_CRASH_ACOUSTIC
CRASH_ACOUSTIC,
#endif
#ifdef USE_CRASH_NOISE
CRASH_NOISE,
#endif
#ifdef USE_CRASH_TAPE
CRASH_TAPE,
#endif
#ifdef USE_HIHAT_808
HIHAT_808,
#endif
#ifdef USE_HIHAT_ACOUSTIC01
HIHAT_ACOUSTIC01,
#endif
#ifdef USE_HIHAT_ACOUSTIC02
HIHAT_ACOUSTIC02,
#endif
#ifdef USE_HIHAT_ANALOG
HIHAT_ANALOG,
#endif
#ifdef USE_HIHAT_DIGITAL
HIHAT_DIGITAL,
#endif
#ifdef USE_HIHAT_DIST01
HIHAT_DIST01,
#endif
#ifdef USE_HIHAT_DIST02
HIHAT_DIST02,
#endif
#ifdef USE_HIHAT_ELECTRO
HIHAT_ELECTRO,
#endif
#ifdef USE_HIHAT_PLAIN
HIHAT_PLAIN,
#endif
#ifdef USE_HIHAT_RESO
HIHAT_RESO,
#endif
#ifdef USE_HIHAT_RING
HIHAT_RING,
#endif
#ifdef USE_KICK_808
KICK_808,
#endif
#ifdef USE_KICK_ACOUSTIC01
KICK_ACOUSTIC01,
#endif
#ifdef USE_KICK_ACOUSTIC02
KICK_ACOUSTIC02,
#endif
#ifdef USE_KICK_BIG
KICK_BIG,
#endif
#ifdef USE_KICK_CLASSIC
KICK_CLASSIC,
#endif
#ifdef USE_KICK_CULTIVATOR
KICK_CULTIVATOR,
#endif
#ifdef USE_KICK_DEEP
KICK_DEEP,
#endif
#ifdef USE_KICK_DRY
KICK_DRY,
#endif
#ifdef USE_KICK_ELECTRO01
KICK_ELECTRO01,
#endif
#ifdef USE_KICK_ELECTRO02
KICK_ELECTRO02,
#endif
#ifdef USE_KICK_FLOPPY
KICK_FLOPPY,
#endif
#ifdef USE_KICK_GRITTY
KICK_GRITTY,
#endif
#ifdef USE_KICK_HEAVY
KICK_HEAVY,
#endif
#ifdef USE_KICK_NEWWAVE
KICK_NEWWAVE,
#endif
#ifdef USE_KICK_OLDSCHOOL
KICK_OLDSCHOOL,
#endif
#ifdef USE_KICK_PLAIN
KICK_PLAIN,
#endif
#ifdef USE_KICK_SLAPBACK
KICK_SLAPBACK,
#endif
#ifdef USE_KICK_SOFTY
KICK_SOFTY,
#endif
#ifdef USE_KICK_STOMP
KICK_STOMP,
#endif
#ifdef USE_KICK_TAPE
KICK_TAPE,
#endif
#ifdef USE_KICK_THUMP
KICK_THUMP,
#endif
#ifdef USE_KICK_TIGHT
KICK_TIGHT,
#endif
#ifdef USE_KICK_TRON
KICK_TRON,
#endif
#ifdef USE_KICK_VINYL01
KICK_VINYL01,
#endif
#ifdef USE_KICK_VINYL02
KICK_VINYL02,
#endif
#ifdef USE_KICK_ZAPPER
KICK_ZAPPER,
#endif
#ifdef USE_OPENHAT_808
OPENHAT_808,
#endif
#ifdef USE_OPENHAT_ACOUSTIC01
OPENHAT_ACOUSTIC01,
#endif
#ifdef USE_OPENHAT_ANALOG
OPENHAT_ANALOG,
#endif
#ifdef USE_OPENHAT_SLICK
OPENHAT_SLICK,
#endif
#ifdef USE_OPENHAT_TIGHT
OPENHAT_TIGHT,
#endif
#ifdef USE_PERC_808
PERC_808,
#endif
#ifdef USE_PERC_CHIRPY
PERC_CHIRPY,
#endif
#ifdef USE_PERC_HOLLOW
PERC_HOLLOW,
#endif
#ifdef USE_PERC_LASER
PERC_LASER,
#endif
#ifdef USE_PERC_METAL
PERC_METAL,
#endif
#ifdef USE_PERC_NASTY
PERC_NASTY,
#endif
#ifdef USE_PERC_SHORT
PERC_SHORT,
#endif
#ifdef USE_PERC_TAMBO
PERC_TAMBO,
#endif
#ifdef USE_PERC_TRIBAL
PERC_TRIBAL,
#endif
#ifdef USE_PERC_WEIRDO
PERC_WEIRDO,
#endif
#ifdef USE_RIDE_ACOUSTIC01
RIDE_ACOUSTIC01,
#endif
#ifdef USE_RIDE_ACOUSTIC02
RIDE_ACOUSTIC02,
#endif
#ifdef USE_SHAKER_ANALOG
SHAKER_ANALOG,
#endif
#ifdef USE_SHAKER_SHUFFLE
SHAKER_SHUFFLE,
#endif
#ifdef USE_SHAKER_SUCKUP
SHAKER_SUCKUP,
#endif
#ifdef USE_SNARE_808
SNARE_808,
#endif
#ifdef USE_SNARE_ACOUSTIC01
SNARE_ACOUSTIC01,
#endif
#ifdef USE_SNARE_ACOUSTIC02
SNARE_ACOUSTIC02,
#endif
#ifdef USE_SNARE_ANALOG
SNARE_ANALOG,
#endif
#ifdef USE_SNARE_BIG
SNARE_BIG,
#endif
#ifdef USE_SNARE_BLOCK
SNARE_BLOCK,
#endif
#ifdef USE_SNARE_BRUTE
SNARE_BRUTE,
#endif
#ifdef USE_SNARE_DIST01
SNARE_DIST01,
#endif
#ifdef USE_SNARE_DIST02
SNARE_DIST02,
#endif
#ifdef USE_SNARE_DIST03
SNARE_DIST03,
#endif
#ifdef USE_SNARE_ELECTRO
SNARE_ELECTRO,
#endif
#ifdef USE_SNARE_LOFI01
SNARE_LOFI01,
#endif
#ifdef USE_SNARE_LOFI02
SNARE_LOFI02,
#endif
#ifdef USE_SNARE_MODULAR
SNARE_MODULAR,
#endif
#ifdef USE_SNARE_NOISE
SNARE_NOISE,
#endif
#ifdef USE_SNARE_PINCH
SNARE_PINCH,
#endif
#ifdef USE_SNARE_PUNCH
SNARE_PUNCH,
#endif
#ifdef USE_SNARE_SMASHER
SNARE_SMASHER,
#endif
#ifdef USE_SNARE_SUMO
SNARE_SUMO,
#endif
#ifdef USE_SNARE_TAPE
SNARE_TAPE,
#endif
#ifdef USE_SNARE_VINYL01
SNARE_VINYL01,
#endif
#ifdef USE_SNARE_VINYL02
SNARE_VINYL02,
#endif
#ifdef USE_TOM_808
TOM_808,
#endif
#ifdef USE_TOM_ACOUSTIC01
TOM_ACOUSTIC01,
#endif
#ifdef USE_TOM_ACOUSTIC02
TOM_ACOUSTIC02,
#endif
#ifdef USE_TOM_ANALOG
TOM_ANALOG,
#endif
#ifdef USE_TOM_CHIPTUNE
TOM_CHIPTUNE,
#endif
#ifdef USE_TOM_FM
TOM_FM,
#endif
#ifdef USE_TOM_LOFI
TOM_LOFI,
#endif
#ifdef USE_TOM_ROTOTOM
TOM_ROTOTOM,
#endif
#ifdef USE_TOM_SHORT
TOM_SHORT,
#endif
