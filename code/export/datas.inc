#ifdef USE_AMEN_BDHH_2
static const unsigned char amen_bdhh_2_data[] PROGMEM = {
#include "data/amen_bdhh_2.inc"
};
#endif
#ifdef USE_AMEN_BDHH_3
static const unsigned char amen_bdhh_3_data[] PROGMEM = {
#include "data/amen_bdhh_3.inc"
};
#endif
#ifdef USE_AMEN_BDHH_4
static const unsigned char amen_bdhh_4_data[] PROGMEM = {
#include "data/amen_bdhh_4.inc"
};
#endif
#ifdef USE_AMEN_BDHH_5
static const unsigned char amen_bdhh_5_data[] PROGMEM = {
#include "data/amen_bdhh_5.inc"
};
#endif
#ifdef USE_AMEN_BDHH
static const unsigned char amen_bdhh_data[] PROGMEM = {
#include "data/amen_bdhh.inc"
};
#endif
#ifdef USE_AMEN_BDHHSOFT_2
static const unsigned char amen_bdhhsoft_2_data[] PROGMEM = {
#include "data/amen_bdhhsoft_2.inc"
};
#endif
#ifdef USE_AMEN_BDHHSOFT_3
static const unsigned char amen_bdhhsoft_3_data[] PROGMEM = {
#include "data/amen_bdhhsoft_3.inc"
};
#endif
#ifdef USE_AMEN_BDHHSOFT
static const unsigned char amen_bdhhsoft_data[] PROGMEM = {
#include "data/amen_bdhhsoft.inc"
};
#endif
#ifdef USE_AMEN_BDSOFT_2
static const unsigned char amen_bdsoft_2_data[] PROGMEM = {
#include "data/amen_bdsoft_2.inc"
};
#endif
#ifdef USE_AMEN_BDSOFT_3
static const unsigned char amen_bdsoft_3_data[] PROGMEM = {
#include "data/amen_bdsoft_3.inc"
};
#endif
#ifdef USE_AMEN_BDSOFT
static const unsigned char amen_bdsoft_data[] PROGMEM = {
#include "data/amen_bdsoft.inc"
};
#endif
#ifdef USE_AMEN_CRASHBD
static const unsigned char amen_crashbd_data[] PROGMEM = {
#include "data/amen_crashbd.inc"
};
#endif
#ifdef USE_AMEN_HH_10
static const unsigned char amen_hh_10_data[] PROGMEM = {
#include "data/amen_hh_10.inc"
};
#endif
#ifdef USE_AMEN_HH_11
static const unsigned char amen_hh_11_data[] PROGMEM = {
#include "data/amen_hh_11.inc"
};
#endif
#ifdef USE_AMEN_HH_2
static const unsigned char amen_hh_2_data[] PROGMEM = {
#include "data/amen_hh_2.inc"
};
#endif
#ifdef USE_AMEN_HH_3
static const unsigned char amen_hh_3_data[] PROGMEM = {
#include "data/amen_hh_3.inc"
};
#endif
#ifdef USE_AMEN_HH_4
static const unsigned char amen_hh_4_data[] PROGMEM = {
#include "data/amen_hh_4.inc"
};
#endif
#ifdef USE_AMEN_HH_5
static const unsigned char amen_hh_5_data[] PROGMEM = {
#include "data/amen_hh_5.inc"
};
#endif
#ifdef USE_AMEN_HH_6
static const unsigned char amen_hh_6_data[] PROGMEM = {
#include "data/amen_hh_6.inc"
};
#endif
#ifdef USE_AMEN_HH_7
static const unsigned char amen_hh_7_data[] PROGMEM = {
#include "data/amen_hh_7.inc"
};
#endif
#ifdef USE_AMEN_HH_8
static const unsigned char amen_hh_8_data[] PROGMEM = {
#include "data/amen_hh_8.inc"
};
#endif
#ifdef USE_AMEN_HH_9
static const unsigned char amen_hh_9_data[] PROGMEM = {
#include "data/amen_hh_9.inc"
};
#endif
#ifdef USE_AMEN_HH
static const unsigned char amen_hh_data[] PROGMEM = {
#include "data/amen_hh.inc"
};
#endif
#ifdef USE_AMEN_HIT
static const unsigned char amen_hit_data[] PROGMEM = {
#include "data/amen_hit.inc"
};
#endif
#ifdef USE_AMEN_LOUDBDHH
static const unsigned char amen_loudbdhh_data[] PROGMEM = {
#include "data/amen_loudbdhh.inc"
};
#endif
#ifdef USE_AMEN_RIDE
static const unsigned char amen_ride_data[] PROGMEM = {
#include "data/amen_ride.inc"
};
#endif
#ifdef USE_AMEN_SNARE_2
static const unsigned char amen_snare_2_data[] PROGMEM = {
#include "data/amen_snare_2.inc"
};
#endif
#ifdef USE_AMEN_SNARE_3
static const unsigned char amen_snare_3_data[] PROGMEM = {
#include "data/amen_snare_3.inc"
};
#endif
#ifdef USE_AMEN_SNARE_4
static const unsigned char amen_snare_4_data[] PROGMEM = {
#include "data/amen_snare_4.inc"
};
#endif
#ifdef USE_AMEN_SNARE_5
static const unsigned char amen_snare_5_data[] PROGMEM = {
#include "data/amen_snare_5.inc"
};
#endif
#ifdef USE_AMEN_SNARE_6
static const unsigned char amen_snare_6_data[] PROGMEM = {
#include "data/amen_snare_6.inc"
};
#endif
#ifdef USE_AMEN_SNARE
static const unsigned char amen_snare_data[] PROGMEM = {
#include "data/amen_snare.inc"
};
#endif
#ifdef USE_AMEN_SNAREHARD
static const unsigned char amen_snarehard_data[] PROGMEM = {
#include "data/amen_snarehard.inc"
};
#endif
#ifdef USE_AMEN_SNAREHISS
static const unsigned char amen_snarehiss_data[] PROGMEM = {
#include "data/amen_snarehiss.inc"
};
#endif
#ifdef USE_AMEN_SOFTSNARE_10
static const unsigned char amen_softsnare_10_data[] PROGMEM = {
#include "data/amen_softsnare_10.inc"
};
#endif
#ifdef USE_AMEN_SOFTSNARE_11
static const unsigned char amen_softsnare_11_data[] PROGMEM = {
#include "data/amen_softsnare_11.inc"
};
#endif
#ifdef USE_AMEN_SOFTSNARE_2
static const unsigned char amen_softsnare_2_data[] PROGMEM = {
#include "data/amen_softsnare_2.inc"
};
#endif
#ifdef USE_AMEN_SOFTSNARE_3
static const unsigned char amen_softsnare_3_data[] PROGMEM = {
#include "data/amen_softsnare_3.inc"
};
#endif
#ifdef USE_AMEN_SOFTSNARE_4
static const unsigned char amen_softsnare_4_data[] PROGMEM = {
#include "data/amen_softsnare_4.inc"
};
#endif
#ifdef USE_AMEN_SOFTSNARE_5
static const unsigned char amen_softsnare_5_data[] PROGMEM = {
#include "data/amen_softsnare_5.inc"
};
#endif
#ifdef USE_AMEN_SOFTSNARE_6
static const unsigned char amen_softsnare_6_data[] PROGMEM = {
#include "data/amen_softsnare_6.inc"
};
#endif
#ifdef USE_AMEN_SOFTSNARE_7
static const unsigned char amen_softsnare_7_data[] PROGMEM = {
#include "data/amen_softsnare_7.inc"
};
#endif
#ifdef USE_AMEN_SOFTSNARE_8
static const unsigned char amen_softsnare_8_data[] PROGMEM = {
#include "data/amen_softsnare_8.inc"
};
#endif
#ifdef USE_AMEN_SOFTSNARE_9
static const unsigned char amen_softsnare_9_data[] PROGMEM = {
#include "data/amen_softsnare_9.inc"
};
#endif
#ifdef USE_AMEN_SOFTSNARE
static const unsigned char amen_softsnare_data[] PROGMEM = {
#include "data/amen_softsnare.inc"
};
#endif
#ifdef USE_GURO_HTFL_HT_015_03
#endif
#ifdef USE_GURO_SCFL_HT_015_03
#endif
#ifdef USE_JK_PRC_03
#endif
#ifdef USE_JK_PRC_04
static const unsigned char jk_prc_04_data[] PROGMEM = {
#include "data/jk_prc_04.inc"
};
#endif
#ifdef USE_JK_PRC_05
static const unsigned char jk_prc_05_data[] PROGMEM = {
#include "data/jk_prc_05.inc"
};
#endif
#ifdef USE_JK_PRC_06
static const unsigned char jk_prc_06_data[] PROGMEM = {
#include "data/jk_prc_06.inc"
};
#endif
#ifdef USE_JK_PRC_09
#endif
#ifdef USE_JK_PRC_10
#endif
#ifdef USE_JK_SNR_01
static const unsigned char jk_snr_01_data[] PROGMEM = {
#include "data/jk_snr_01.inc"
};
#endif
#ifdef USE_JK_SNR_02
static const unsigned char jk_snr_02_data[] PROGMEM = {
#include "data/jk_snr_02.inc"
};
#endif
#ifdef USE_JK_SNR_03
static const unsigned char jk_snr_03_data[] PROGMEM = {
#include "data/jk_snr_03.inc"
};
#endif
#ifdef USE_JK_SNR_04
static const unsigned char jk_snr_04_data[] PROGMEM = {
#include "data/jk_snr_04.inc"
};
#endif
#ifdef USE_JK_SNR_07
static const unsigned char jk_snr_07_data[] PROGMEM = {
#include "data/jk_snr_07.inc"
};
#endif
#ifdef USE_L400_SNR_DCFL_HT_03
static const unsigned char l400_snr_dcfl_ht_03_data[] PROGMEM = {
#include "data/l400_snr_dcfl_ht_03.inc"
};
#endif
#ifdef USE_L400_SNR_DEFL_HT_03
static const unsigned char l400_snr_defl_ht_03_data[] PROGMEM = {
#include "data/l400_snr_defl_ht_03.inc"
};
#endif
#ifdef USE_L400_SNR_DRFL_HT_03
static const unsigned char l400_snr_drfl_ht_03_data[] PROGMEM = {
#include "data/l400_snr_drfl_ht_03.inc"
};
#endif
#ifdef USE_L400_SNR_LCFL_HT_03
static const unsigned char l400_snr_lcfl_ht_03_data[] PROGMEM = {
#include "data/l400_snr_lcfl_ht_03.inc"
};
#endif
#ifdef USE_L400_SNR_LEFL_HT_03
static const unsigned char l400_snr_lefl_ht_03_data[] PROGMEM = {
#include "data/l400_snr_lefl_ht_03.inc"
};
#endif
#ifdef USE_L400_SNR_LRFL_HT_03
static const unsigned char l400_snr_lrfl_ht_03_data[] PROGMEM = {
#include "data/l400_snr_lrfl_ht_03.inc"
};
#endif
#ifdef USE_L400_SNR_OFFL_HT_03
static const unsigned char l400_snr_offl_ht_03_data[] PROGMEM = {
#include "data/l400_snr_offl_ht_03.inc"
};
#endif
#ifdef USE_L400_SNR_XSFL_HT_03
static const unsigned char l400_snr_xsfl_ht_03_data[] PROGMEM = {
#include "data/l400_snr_xsfl_ht_03.inc"
};
#endif
#ifdef USE_LWFI_SNR_DCFL_HT_03
static const unsigned char lwfi_snr_dcfl_ht_03_data[] PROGMEM = {
#include "data/lwfi_snr_dcfl_ht_03.inc"
};
#endif
#ifdef USE_LWFI_SNR_DEFL_HT_03
static const unsigned char lwfi_snr_defl_ht_03_data[] PROGMEM = {
#include "data/lwfi_snr_defl_ht_03.inc"
};
#endif
#ifdef USE_LWFI_SNR_DRFL_HT_03
static const unsigned char lwfi_snr_drfl_ht_03_data[] PROGMEM = {
#include "data/lwfi_snr_drfl_ht_03.inc"
};
#endif
#ifdef USE_LWFI_SNR_LCFL_HT_03
static const unsigned char lwfi_snr_lcfl_ht_03_data[] PROGMEM = {
#include "data/lwfi_snr_lcfl_ht_03.inc"
};
#endif
#ifdef USE_LWFI_SNR_LEFL_HT_03
static const unsigned char lwfi_snr_lefl_ht_03_data[] PROGMEM = {
#include "data/lwfi_snr_lefl_ht_03.inc"
};
#endif
#ifdef USE_LWFI_SNR_LRFL_HT_03
static const unsigned char lwfi_snr_lrfl_ht_03_data[] PROGMEM = {
#include "data/lwfi_snr_lrfl_ht_03.inc"
};
#endif
#ifdef USE_LWFI_SNR_OFFL_HT_03
static const unsigned char lwfi_snr_offl_ht_03_data[] PROGMEM = {
#include "data/lwfi_snr_offl_ht_03.inc"
};
#endif
#ifdef USE_LWFI_SNR_XSFL_HT_03
static const unsigned char lwfi_snr_xsfl_ht_03_data[] PROGMEM = {
#include "data/lwfi_snr_xsfl_ht_03.inc"
};
#endif
#ifdef USE_PSTE_CRSH_CNFL_HT_015_03
static const unsigned char pste_crsh_cnfl_ht_015_03_data[] PROGMEM = {
#include "data/pste_crsh_cnfl_ht_015_03.inc"
};
#endif
#ifdef USE_PSTE_CRSH_EGFL_HT_015_03
static const unsigned char pste_crsh_egfl_ht_015_03_data[] PROGMEM = {
#include "data/pste_crsh_egfl_ht_015_03.inc"
};
#endif
#ifdef USE_PSTE_RIDE_BLFL_HT_03
static const unsigned char pste_ride_blfl_ht_03_data[] PROGMEM = {
#include "data/pste_ride_blfl_ht_03.inc"
};
#endif
#ifdef USE_PSTE_RIDE_CNFL_HT_03
static const unsigned char pste_ride_cnfl_ht_03_data[] PROGMEM = {
#include "data/pste_ride_cnfl_ht_03.inc"
};
#endif
#ifdef USE_PSTE_RIDE_EGFL_HT_03
static const unsigned char pste_ride_egfl_ht_03_data[] PROGMEM = {
#include "data/pste_ride_egfl_ht_03.inc"
};
#endif
#ifdef USE_RGRS_FTOM_CNFL_HT_03
static const unsigned char rgrs_ftom_cnfl_ht_03_data[] PROGMEM = {
#include "data/rgrs_ftom_cnfl_ht_03.inc"
};
#endif
#ifdef USE_RGRS_KICK_HDFL_HT_03
static const unsigned char rgrs_kick_hdfl_ht_03_data[] PROGMEM = {
#include "data/rgrs_kick_hdfl_ht_03.inc"
};
#endif
#ifdef USE_RGRS_KICK_SFFL_HT_03
static const unsigned char rgrs_kick_sffl_ht_03_data[] PROGMEM = {
#include "data/rgrs_kick_sffl_ht_03.inc"
};
#endif
#ifdef USE_RGRS_RTOM_CNFL_HT_03
static const unsigned char rgrs_rtom_cnfl_ht_03_data[] PROGMEM = {
#include "data/rgrs_rtom_cnfl_ht_03.inc"
};
#endif
#ifdef USE_SHKR_HDFL_HT_015_03
#endif
#ifdef USE_SHKR_SFFL_HT_015_03
#endif
#ifdef USE_TAMB_HTFL_HT_015_03
#endif
#ifdef USE_TAMB_SHFL_HT_015_03
#endif
#ifdef USE_ZDJN_HAT_C1EGFL_HT_015_01
static const unsigned char zdjn_hat_c1egfl_ht_015_01_data[] PROGMEM = {
#include "data/zdjn_hat_c1egfl_ht_015_01.inc"
};
#endif
#ifdef USE_ZDJN_HAT_C1EGFL_HT_015_02
static const unsigned char zdjn_hat_c1egfl_ht_015_02_data[] PROGMEM = {
#include "data/zdjn_hat_c1egfl_ht_015_02.inc"
};
#endif
#ifdef USE_ZDJN_HAT_C1EGFL_HT_015_03
static const unsigned char zdjn_hat_c1egfl_ht_015_03_data[] PROGMEM = {
#include "data/zdjn_hat_c1egfl_ht_015_03.inc"
};
#endif
#ifdef USE_ZDJN_HAT_C1FL_HT_015_01
static const unsigned char zdjn_hat_c1fl_ht_015_01_data[] PROGMEM = {
#include "data/zdjn_hat_c1fl_ht_015_01.inc"
};
#endif
#ifdef USE_ZDJN_HAT_C1FL_HT_015_02
static const unsigned char zdjn_hat_c1fl_ht_015_02_data[] PROGMEM = {
#include "data/zdjn_hat_c1fl_ht_015_02.inc"
};
#endif
#ifdef USE_ZDJN_HAT_C1FL_HT_015_03
static const unsigned char zdjn_hat_c1fl_ht_015_03_data[] PROGMEM = {
#include "data/zdjn_hat_c1fl_ht_015_03.inc"
};
#endif
#ifdef USE_ZDJN_HAT_C2EGFL_HT_015_01
static const unsigned char zdjn_hat_c2egfl_ht_015_01_data[] PROGMEM = {
#include "data/zdjn_hat_c2egfl_ht_015_01.inc"
};
#endif
#ifdef USE_ZDJN_HAT_C2EGFL_HT_015_02
static const unsigned char zdjn_hat_c2egfl_ht_015_02_data[] PROGMEM = {
#include "data/zdjn_hat_c2egfl_ht_015_02.inc"
};
#endif
#ifdef USE_ZDJN_HAT_C2EGFL_HT_015_03
static const unsigned char zdjn_hat_c2egfl_ht_015_03_data[] PROGMEM = {
#include "data/zdjn_hat_c2egfl_ht_015_03.inc"
};
#endif
#ifdef USE_ZDJN_HAT_C2FL_HT_015_01
static const unsigned char zdjn_hat_c2fl_ht_015_01_data[] PROGMEM = {
#include "data/zdjn_hat_c2fl_ht_015_01.inc"
};
#endif
#ifdef USE_ZDJN_HAT_C2FL_HT_015_02
static const unsigned char zdjn_hat_c2fl_ht_015_02_data[] PROGMEM = {
#include "data/zdjn_hat_c2fl_ht_015_02.inc"
};
#endif
#ifdef USE_ZDJN_HAT_C2FL_HT_015_03
static const unsigned char zdjn_hat_c2fl_ht_015_03_data[] PROGMEM = {
#include "data/zdjn_hat_c2fl_ht_015_03.inc"
};
#endif
#ifdef USE_ZDJN_HAT_C3EGFL_HT_015_03
static const unsigned char zdjn_hat_c3egfl_ht_015_03_data[] PROGMEM = {
#include "data/zdjn_hat_c3egfl_ht_015_03.inc"
};
#endif
#ifdef USE_ZDJN_HAT_C3FL_HT_015_03
static const unsigned char zdjn_hat_c3fl_ht_015_03_data[] PROGMEM = {
#include "data/zdjn_hat_c3fl_ht_015_03.inc"
};
#endif
#ifdef USE_ZDJN_HAT_O1EGFL_HT_015_03
static const unsigned char zdjn_hat_o1egfl_ht_015_03_data[] PROGMEM = {
#include "data/zdjn_hat_o1egfl_ht_015_03.inc"
};
#endif
#ifdef USE_ZDJN_HAT_O1FL_HT_015_03
static const unsigned char zdjn_hat_o1fl_ht_015_03_data[] PROGMEM = {
#include "data/zdjn_hat_o1fl_ht_015_03.inc"
};
#endif
#ifdef USE_ZDJN_HAT_O2EGFL_HT_015_03
static const unsigned char zdjn_hat_o2egfl_ht_015_03_data[] PROGMEM = {
#include "data/zdjn_hat_o2egfl_ht_015_03.inc"
};
#endif
#ifdef USE_ZDJN_HAT_O2FL_HT_015_03
static const unsigned char zdjn_hat_o2fl_ht_015_03_data[] PROGMEM = {
#include "data/zdjn_hat_o2fl_ht_015_03.inc"
};
#endif
#ifdef USE_ZDJN_HAT_O3EGFL_HT_015_03
static const unsigned char zdjn_hat_o3egfl_ht_015_03_data[] PROGMEM = {
#include "data/zdjn_hat_o3egfl_ht_015_03.inc"
};
#endif
#ifdef USE_ZDJN_HAT_O3FL_HT_015_03
static const unsigned char zdjn_hat_o3fl_ht_015_03_data[] PROGMEM = {
#include "data/zdjn_hat_o3fl_ht_015_03.inc"
};
#endif
#ifdef USE_ZDJN_HAT_POFL_HT_015_03
static const unsigned char zdjn_hat_pofl_ht_015_03_data[] PROGMEM = {
#include "data/zdjn_hat_pofl_ht_015_03.inc"
};
#endif
#ifdef USE_ZDJN_HAT_PSFL_HT_015_01
static const unsigned char zdjn_hat_psfl_ht_015_01_data[] PROGMEM = {
#include "data/zdjn_hat_psfl_ht_015_01.inc"
};
#endif
#ifdef USE_ZDJN_HAT_PSFL_HT_015_02
static const unsigned char zdjn_hat_psfl_ht_015_02_data[] PROGMEM = {
#include "data/zdjn_hat_psfl_ht_015_02.inc"
};
#endif
#ifdef USE_ZDJN_HAT_PSFL_HT_015_03
static const unsigned char zdjn_hat_psfl_ht_015_03_data[] PROGMEM = {
#include "data/zdjn_hat_psfl_ht_015_03.inc"
};
#endif
#ifdef USE_CLAP_808
static const unsigned char clap_808_data[] PROGMEM = {
#include "data/clap_808.inc"
};
#endif
#ifdef USE_CLAP_ANALOG
static const unsigned char clap_analog_data[] PROGMEM = {
#include "data/clap_analog.inc"
};
#endif
#ifdef USE_CLAP_CRUSHED
static const unsigned char clap_crushed_data[] PROGMEM = {
#include "data/clap_crushed.inc"
};
#endif
#ifdef USE_CLAP_FAT
static const unsigned char clap_fat_data[] PROGMEM = {
#include "data/clap_fat.inc"
};
#endif
#ifdef USE_CLAP_SLAPPER
static const unsigned char clap_slapper_data[] PROGMEM = {
#include "data/clap_slapper.inc"
};
#endif
#ifdef USE_CLAP_TAPE
static const unsigned char clap_tape_data[] PROGMEM = {
#include "data/clap_tape.inc"
};
#endif
#ifdef USE_COWBELL_808
static const unsigned char cowbell_808_data[] PROGMEM = {
#include "data/cowbell_808.inc"
};
#endif
#ifdef USE_CRASH_808
#endif
#ifdef USE_CRASH_ACOUSTIC
static const unsigned char crash_acoustic_data[] PROGMEM = {
#include "data/crash_acoustic.inc"
};
#endif
#ifdef USE_CRASH_NOISE
#endif
#ifdef USE_CRASH_TAPE
static const unsigned char crash_tape_data[] PROGMEM = {
#include "data/crash_tape.inc"
};
#endif
#ifdef USE_HIHAT_808
#endif
#ifdef USE_HIHAT_ACOUSTIC01
static const unsigned char hihat_acoustic01_data[] PROGMEM = {
#include "data/hihat_acoustic01.inc"
};
#endif
#ifdef USE_HIHAT_ACOUSTIC02
static const unsigned char hihat_acoustic02_data[] PROGMEM = {
#include "data/hihat_acoustic02.inc"
};
#endif
#ifdef USE_HIHAT_ANALOG
static const unsigned char hihat_analog_data[] PROGMEM = {
#include "data/hihat_analog.inc"
};
#endif
#ifdef USE_HIHAT_DIGITAL
#endif
#ifdef USE_HIHAT_DIST01
static const unsigned char hihat_dist01_data[] PROGMEM = {
#include "data/hihat_dist01.inc"
};
#endif
#ifdef USE_HIHAT_DIST02
static const unsigned char hihat_dist02_data[] PROGMEM = {
#include "data/hihat_dist02.inc"
};
#endif
#ifdef USE_HIHAT_ELECTRO
#endif
#ifdef USE_HIHAT_PLAIN
#endif
#ifdef USE_HIHAT_RESO
#endif
#ifdef USE_HIHAT_RING
#endif
#ifdef USE_KICK_808
static const unsigned char kick_808_data[] PROGMEM = {
#include "data/kick_808.inc"
};
#endif
#ifdef USE_KICK_ACOUSTIC01
static const unsigned char kick_acoustic01_data[] PROGMEM = {
#include "data/kick_acoustic01.inc"
};
#endif
#ifdef USE_KICK_ACOUSTIC02
static const unsigned char kick_acoustic02_data[] PROGMEM = {
#include "data/kick_acoustic02.inc"
};
#endif
#ifdef USE_KICK_BIG
static const unsigned char kick_big_data[] PROGMEM = {
#include "data/kick_big.inc"
};
#endif
#ifdef USE_KICK_CLASSIC
static const unsigned char kick_classic_data[] PROGMEM = {
#include "data/kick_classic.inc"
};
#endif
#ifdef USE_KICK_CULTIVATOR
static const unsigned char kick_cultivator_data[] PROGMEM = {
#include "data/kick_cultivator.inc"
};
#endif
#ifdef USE_KICK_DEEP
static const unsigned char kick_deep_data[] PROGMEM = {
#include "data/kick_deep.inc"
};
#endif
#ifdef USE_KICK_DRY
static const unsigned char kick_dry_data[] PROGMEM = {
#include "data/kick_dry.inc"
};
#endif
#ifdef USE_KICK_ELECTRO01
static const unsigned char kick_electro01_data[] PROGMEM = {
#include "data/kick_electro01.inc"
};
#endif
#ifdef USE_KICK_ELECTRO02
static const unsigned char kick_electro02_data[] PROGMEM = {
#include "data/kick_electro02.inc"
};
#endif
#ifdef USE_KICK_FLOPPY
static const unsigned char kick_floppy_data[] PROGMEM = {
#include "data/kick_floppy.inc"
};
#endif
#ifdef USE_KICK_GRITTY
static const unsigned char kick_gritty_data[] PROGMEM = {
#include "data/kick_gritty.inc"
};
#endif
#ifdef USE_KICK_HEAVY
static const unsigned char kick_heavy_data[] PROGMEM = {
#include "data/kick_heavy.inc"
};
#endif
#ifdef USE_KICK_NEWWAVE
static const unsigned char kick_newwave_data[] PROGMEM = {
#include "data/kick_newwave.inc"
};
#endif
#ifdef USE_KICK_OLDSCHOOL
static const unsigned char kick_oldschool_data[] PROGMEM = {
#include "data/kick_oldschool.inc"
};
#endif
#ifdef USE_KICK_PLAIN
static const unsigned char kick_plain_data[] PROGMEM = {
#include "data/kick_plain.inc"
};
#endif
#ifdef USE_KICK_SLAPBACK
static const unsigned char kick_slapback_data[] PROGMEM = {
#include "data/kick_slapback.inc"
};
#endif
#ifdef USE_KICK_SOFTY
static const unsigned char kick_softy_data[] PROGMEM = {
#include "data/kick_softy.inc"
};
#endif
#ifdef USE_KICK_STOMP
static const unsigned char kick_stomp_data[] PROGMEM = {
#include "data/kick_stomp.inc"
};
#endif
#ifdef USE_KICK_TAPE
static const unsigned char kick_tape_data[] PROGMEM = {
#include "data/kick_tape.inc"
};
#endif
#ifdef USE_KICK_THUMP
static const unsigned char kick_thump_data[] PROGMEM = {
#include "data/kick_thump.inc"
};
#endif
#ifdef USE_KICK_TIGHT
static const unsigned char kick_tight_data[] PROGMEM = {
#include "data/kick_tight.inc"
};
#endif
#ifdef USE_KICK_TRON
static const unsigned char kick_tron_data[] PROGMEM = {
#include "data/kick_tron.inc"
};
#endif
#ifdef USE_KICK_VINYL01
static const unsigned char kick_vinyl01_data[] PROGMEM = {
#include "data/kick_vinyl01.inc"
};
#endif
#ifdef USE_KICK_VINYL02
static const unsigned char kick_vinyl02_data[] PROGMEM = {
#include "data/kick_vinyl02.inc"
};
#endif
#ifdef USE_KICK_ZAPPER
static const unsigned char kick_zapper_data[] PROGMEM = {
#include "data/kick_zapper.inc"
};
#endif
#ifdef USE_OPENHAT_808
#endif
#ifdef USE_OPENHAT_ACOUSTIC01
static const unsigned char openhat_acoustic01_data[] PROGMEM = {
#include "data/openhat_acoustic01.inc"
};
#endif
#ifdef USE_OPENHAT_ANALOG
#endif
#ifdef USE_OPENHAT_SLICK
#endif
#ifdef USE_OPENHAT_TIGHT
#endif
#ifdef USE_PERC_808
static const unsigned char perc_808_data[] PROGMEM = {
#include "data/perc_808.inc"
};
#endif
#ifdef USE_PERC_CHIRPY
#endif
#ifdef USE_PERC_HOLLOW
static const unsigned char perc_hollow_data[] PROGMEM = {
#include "data/perc_hollow.inc"
};
#endif
#ifdef USE_PERC_LASER
static const unsigned char perc_laser_data[] PROGMEM = {
#include "data/perc_laser.inc"
};
#endif
#ifdef USE_PERC_METAL
#endif
#ifdef USE_PERC_NASTY
static const unsigned char perc_nasty_data[] PROGMEM = {
#include "data/perc_nasty.inc"
};
#endif
#ifdef USE_PERC_SHORT
static const unsigned char perc_short_data[] PROGMEM = {
#include "data/perc_short.inc"
};
#endif
#ifdef USE_PERC_TAMBO
#endif
#ifdef USE_PERC_TRIBAL
static const unsigned char perc_tribal_data[] PROGMEM = {
#include "data/perc_tribal.inc"
};
#endif
#ifdef USE_PERC_WEIRDO
static const unsigned char perc_weirdo_data[] PROGMEM = {
#include "data/perc_weirdo.inc"
};
#endif
#ifdef USE_RIDE_ACOUSTIC01
static const unsigned char ride_acoustic01_data[] PROGMEM = {
#include "data/ride_acoustic01.inc"
};
#endif
#ifdef USE_RIDE_ACOUSTIC02
static const unsigned char ride_acoustic02_data[] PROGMEM = {
#include "data/ride_acoustic02.inc"
};
#endif
#ifdef USE_SHAKER_ANALOG
static const unsigned char shaker_analog_data[] PROGMEM = {
#include "data/shaker_analog.inc"
};
#endif
#ifdef USE_SHAKER_SHUFFLE
#endif
#ifdef USE_SHAKER_SUCKUP
#endif
#ifdef USE_SNARE_808
static const unsigned char snare_808_data[] PROGMEM = {
#include "data/snare_808.inc"
};
#endif
#ifdef USE_SNARE_ACOUSTIC01
static const unsigned char snare_acoustic01_data[] PROGMEM = {
#include "data/snare_acoustic01.inc"
};
#endif
#ifdef USE_SNARE_ACOUSTIC02
static const unsigned char snare_acoustic02_data[] PROGMEM = {
#include "data/snare_acoustic02.inc"
};
#endif
#ifdef USE_SNARE_ANALOG
static const unsigned char snare_analog_data[] PROGMEM = {
#include "data/snare_analog.inc"
};
#endif
#ifdef USE_SNARE_BIG
static const unsigned char snare_big_data[] PROGMEM = {
#include "data/snare_big.inc"
};
#endif
#ifdef USE_SNARE_BLOCK
static const unsigned char snare_block_data[] PROGMEM = {
#include "data/snare_block.inc"
};
#endif
#ifdef USE_SNARE_BRUTE
static const unsigned char snare_brute_data[] PROGMEM = {
#include "data/snare_brute.inc"
};
#endif
#ifdef USE_SNARE_DIST01
static const unsigned char snare_dist01_data[] PROGMEM = {
#include "data/snare_dist01.inc"
};
#endif
#ifdef USE_SNARE_DIST02
static const unsigned char snare_dist02_data[] PROGMEM = {
#include "data/snare_dist02.inc"
};
#endif
#ifdef USE_SNARE_DIST03
static const unsigned char snare_dist03_data[] PROGMEM = {
#include "data/snare_dist03.inc"
};
#endif
#ifdef USE_SNARE_ELECTRO
static const unsigned char snare_electro_data[] PROGMEM = {
#include "data/snare_electro.inc"
};
#endif
#ifdef USE_SNARE_LOFI01
static const unsigned char snare_lofi01_data[] PROGMEM = {
#include "data/snare_lofi01.inc"
};
#endif
#ifdef USE_SNARE_LOFI02
static const unsigned char snare_lofi02_data[] PROGMEM = {
#include "data/snare_lofi02.inc"
};
#endif
#ifdef USE_SNARE_MODULAR
static const unsigned char snare_modular_data[] PROGMEM = {
#include "data/snare_modular.inc"
};
#endif
#ifdef USE_SNARE_NOISE
static const unsigned char snare_noise_data[] PROGMEM = {
#include "data/snare_noise.inc"
};
#endif
#ifdef USE_SNARE_PINCH
static const unsigned char snare_pinch_data[] PROGMEM = {
#include "data/snare_pinch.inc"
};
#endif
#ifdef USE_SNARE_PUNCH
static const unsigned char snare_punch_data[] PROGMEM = {
#include "data/snare_punch.inc"
};
#endif
#ifdef USE_SNARE_SMASHER
static const unsigned char snare_smasher_data[] PROGMEM = {
#include "data/snare_smasher.inc"
};
#endif
#ifdef USE_SNARE_SUMO
static const unsigned char snare_sumo_data[] PROGMEM = {
#include "data/snare_sumo.inc"
};
#endif
#ifdef USE_SNARE_TAPE
static const unsigned char snare_tape_data[] PROGMEM = {
#include "data/snare_tape.inc"
};
#endif
#ifdef USE_SNARE_VINYL01
static const unsigned char snare_vinyl01_data[] PROGMEM = {
#include "data/snare_vinyl01.inc"
};
#endif
#ifdef USE_SNARE_VINYL02
static const unsigned char snare_vinyl02_data[] PROGMEM = {
#include "data/snare_vinyl02.inc"
};
#endif
#ifdef USE_TOM_808
static const unsigned char tom_808_data[] PROGMEM = {
#include "data/tom_808.inc"
};
#endif
#ifdef USE_TOM_ACOUSTIC01
static const unsigned char tom_acoustic01_data[] PROGMEM = {
#include "data/tom_acoustic01.inc"
};
#endif
#ifdef USE_TOM_ACOUSTIC02
static const unsigned char tom_acoustic02_data[] PROGMEM = {
#include "data/tom_acoustic02.inc"
};
#endif
#ifdef USE_TOM_ANALOG
static const unsigned char tom_analog_data[] PROGMEM = {
#include "data/tom_analog.inc"
};
#endif
#ifdef USE_TOM_CHIPTUNE
static const unsigned char tom_chiptune_data[] PROGMEM = {
#include "data/tom_chiptune.inc"
};
#endif
#ifdef USE_TOM_FM
static const unsigned char tom_fm_data[] PROGMEM = {
#include "data/tom_fm.inc"
};
#endif
#ifdef USE_TOM_LOFI
static const unsigned char tom_lofi_data[] PROGMEM = {
#include "data/tom_lofi.inc"
};
#endif
#ifdef USE_TOM_ROTOTOM
static const unsigned char tom_rototom_data[] PROGMEM = {
#include "data/tom_rototom.inc"
};
#endif
#ifdef USE_TOM_SHORT
static const unsigned char tom_short_data[] PROGMEM = {
#include "data/tom_short.inc"
};
#endif
