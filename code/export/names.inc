"amen_bdhh_2",
"amen_bdhh_3",
"amen_bdhh_4",
"amen_bdhh_5",
"amen_bdhh",
"amen_bdhhsoft_2",
"amen_bdhhsoft_3",
"amen_bdhhsoft",
"amen_bdsoft_2",
"amen_bdsoft_3",
"amen_bdsoft",
"amen_crashbd",
"amen_hh_10",
"amen_hh_11",
"amen_hh_2",
"amen_hh_3",
"amen_hh_4",
"amen_hh_5",
"amen_hh_6",
"amen_hh_7",
"amen_hh_8",
"amen_hh_9",
"amen_hh",
"amen_hit",
"amen_loudbdhh",
"amen_ride",
"amen_snare_2",
"amen_snare_3",
"amen_snare_4",
"amen_snare_5",
"amen_snare_6",
"amen_snare",
"amen_snarehard",
"amen_snarehiss",
"amen_softsnare_10",
"amen_softsnare_11",
"amen_softsnare_2",
"amen_softsnare_3",
"amen_softsnare_4",
"amen_softsnare_5",
"amen_softsnare_6",
"amen_softsnare_7",
"amen_softsnare_8",
"amen_softsnare_9",
"amen_softsnare",
"guro_htfl_ht_015_03",
"guro_scfl_ht_015_03",
"jk_prc_03",
"jk_prc_04",
"jk_prc_05",
"jk_prc_06",
"jk_prc_09",
"jk_prc_10",
"jk_snr_01",
"jk_snr_02",
"jk_snr_03",
"jk_snr_04",
"jk_snr_07",
"l400_snr_dcfl_ht_03",
"l400_snr_defl_ht_03",
"l400_snr_drfl_ht_03",
"l400_snr_lcfl_ht_03",
"l400_snr_lefl_ht_03",
"l400_snr_lrfl_ht_03",
"l400_snr_offl_ht_03",
"l400_snr_xsfl_ht_03",
"lwfi_snr_dcfl_ht_03",
"lwfi_snr_defl_ht_03",
"lwfi_snr_drfl_ht_03",
"lwfi_snr_lcfl_ht_03",
"lwfi_snr_lefl_ht_03",
"lwfi_snr_lrfl_ht_03",
"lwfi_snr_offl_ht_03",
"lwfi_snr_xsfl_ht_03",
"pste_crsh_cnfl_ht_015_03",
"pste_crsh_egfl_ht_015_03",
"pste_ride_blfl_ht_03",
"pste_ride_cnfl_ht_03",
"pste_ride_egfl_ht_03",
"rgrs_ftom_cnfl_ht_03",
"rgrs_kick_hdfl_ht_03",
"rgrs_kick_sffl_ht_03",
"rgrs_rtom_cnfl_ht_03",
"shkr_hdfl_ht_015_03",
"shkr_sffl_ht_015_03",
"tamb_htfl_ht_015_03",
"tamb_shfl_ht_015_03",
"zdjn_hat_c1egfl_ht_015_01",
"zdjn_hat_c1egfl_ht_015_02",
"zdjn_hat_c1egfl_ht_015_03",
"zdjn_hat_c1fl_ht_015_01",
"zdjn_hat_c1fl_ht_015_02",
"zdjn_hat_c1fl_ht_015_03",
"zdjn_hat_c2egfl_ht_015_01",
"zdjn_hat_c2egfl_ht_015_02",
"zdjn_hat_c2egfl_ht_015_03",
"zdjn_hat_c2fl_ht_015_01",
"zdjn_hat_c2fl_ht_015_02",
"zdjn_hat_c2fl_ht_015_03",
"zdjn_hat_c3egfl_ht_015_03",
"zdjn_hat_c3fl_ht_015_03",
"zdjn_hat_o1egfl_ht_015_03",
"zdjn_hat_o1fl_ht_015_03",
"zdjn_hat_o2egfl_ht_015_03",
"zdjn_hat_o2fl_ht_015_03",
"zdjn_hat_o3egfl_ht_015_03",
"zdjn_hat_o3fl_ht_015_03",
"zdjn_hat_pofl_ht_015_03",
"zdjn_hat_psfl_ht_015_01",
"zdjn_hat_psfl_ht_015_02",
"zdjn_hat_psfl_ht_015_03",
"clap_808",
"clap_analog",
"clap_crushed",
"clap_fat",
"clap_slapper",
"clap_tape",
"cowbell_808",
"crash_808",
"crash_acoustic",
"crash_noise",
"crash_tape",
"hihat_808",
"hihat_acoustic01",
"hihat_acoustic02",
"hihat_analog",
"hihat_digital",
"hihat_dist01",
"hihat_dist02",
"hihat_electro",
"hihat_plain",
"hihat_reso",
"hihat_ring",
"kick_808",
"kick_acoustic01",
"kick_acoustic02",
"kick_big",
"kick_classic",
"kick_cultivator",
"kick_deep",
"kick_dry",
"kick_electro01",
"kick_electro02",
"kick_floppy",
"kick_gritty",
"kick_heavy",
"kick_newwave",
"kick_oldschool",
"kick_plain",
"kick_slapback",
"kick_softy",
"kick_stomp",
"kick_tape",
"kick_thump",
"kick_tight",
"kick_tron",
"kick_vinyl01",
"kick_vinyl02",
"kick_zapper",
"openhat_808",
"openhat_acoustic01",
"openhat_analog",
"openhat_slick",
"openhat_tight",
"perc_808",
"perc_chirpy",
"perc_hollow",
"perc_laser",
"perc_metal",
"perc_nasty",
"perc_short",
"perc_tambo",
"perc_tribal",
"perc_weirdo",
"ride_acoustic01",
"ride_acoustic02",
"shaker_analog",
"shaker_shuffle",
"shaker_suckup",
"snare_808",
"snare_acoustic01",
"snare_acoustic02",
"snare_analog",
"snare_big",
"snare_block",
"snare_brute",
"snare_dist01",
"snare_dist02",
"snare_dist03",
"snare_electro",
"snare_lofi01",
"snare_lofi02",
"snare_modular",
"snare_noise",
"snare_pinch",
"snare_punch",
"snare_smasher",
"snare_sumo",
"snare_tape",
"snare_vinyl01",
"snare_vinyl02",
"tom_808",
"tom_acoustic01",
"tom_acoustic02",
"tom_analog",
"tom_chiptune",
"tom_fm",
"tom_lofi",
"tom_rototom",
"tom_short",
