187,138,145,202,30,206,155,235,213,27,108,176,237,144,3,173,151,237,181,249,92,38,124,100,242,75,133,62,211,165,250,69,47,136,204,4,14,46,62,21,238,46,236,147,200,8,35,31,40,35,48,0,129,140,11,3,180,178,35,240,96,50,46,203,140,185,187,11,51,164,236,8,251,24,50,46,12,222,40,35,48,78,163,236,194,78,181,238,178,251,132,235,8,3,108,172,227,142,79,133,14,142,51,84,250,58,62,94,201,58,82,143,81,128,179,140,87,8,0,176,23,1,2,48,82,68,45,192,0,148,141,187,12,80,68,9,227,22,85,21,12,82,84,85,212,142,23,85,81,142,23,20,81,80,14,84,81,81,0,80,84,17,20,64,65,68,69,1,84,89,85,93,80,20,85,17,65,65,17,17,85,20,69,21,81,68,80,68,144,85,85,23,17,85,149,85,117,68,68,101,85,29,17,17,100,87,21,65,