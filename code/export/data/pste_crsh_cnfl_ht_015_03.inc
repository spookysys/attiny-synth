150,105,86,71,199,231,152,17,7,101,118,16,70,71,100,117,23,89,17,17,196,81,180,29,70,145,29,85,68,228,105,87,135,25,29,81,17,100,135,93,85,217,213,121,210,182,81,29,103,85,155,144,68,100,183,217,209,97,151,61,33,81,213,121,16,145,29,93,145,21,21,100,21,81,135,209,21,25,213,17,167,209,145,93,149,21,21,29,149,17,149,17,21,213,213,25,221,97,70,24,85,213,89,85,213,65,103,116,156,213,81,70,87,5,121,214,65,25,52,21,69,72,80,17,17,81,109,99,83,21,65,158,85,17,70,69,100,27,85,29,118,69,116,64,18,157,21,77,87,164,209,65,84,85,17,246,198,85,148,73,23,21,25,157,81,217,157,209,109,99,71,30,69,100,84,144,85,244,4,132,69,76,70,118,208,101,70,69,101,84,118,119,197,105,69,53,81,27,109,210,27,69,70,111,16,29,89,81,17,81,81,17,209,70,17,17,147,118,70,87,87,