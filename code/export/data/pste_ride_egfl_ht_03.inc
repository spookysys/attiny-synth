32,33,73,24,106,77,121,199,77,153,221,146,102,248,73,109,5,193,87,100,103,117,70,211,84,117,86,102,119,85,101,118,101,165,76,119,117,155,29,21,217,113,82,25,93,4,217,17,109,70,84,116,7,97,118,147,29,102,103,69,87,71,149,217,217,109,219,101,27,21,81,196,36,77,155,25,221,65,154,221,102,71,117,86,117,83,25,145,209,21,157,209,157,21,209,132,221,149,153,209,17,149,153,93,209,77,30,70,5,177,217,81,117,158,39,113,92,97,148,93,102,55,77,100,102,87,116,70,103,68,69,101,166,223,29,157,25,29,209,25,17,29,145,209,39,36,65,191,97,85,85,69,83,97,118,27,149,217,81,17,17,21,217,93,221,88,25,109,118,84,71,155,7,145,217,209,102,103,117,91,149,93,217,145,209,81,217,221,6,109,68,68,24,71,89,89,25,221,17,109,219,209,217,164,65,16,153,221,21,217,109,70,87,17,183,89,25,209,85,109,144,29,71,36,25,77,147,29,217,21,29,102,52,217,89,153,221,213,17,97,68,219,21,93,26,68,25,213,65,27,17,77,80,145,213,102,117,67,64,18,117,96,16,71,65,75,70,118,84,39,97,84,147,180,209,81,29,100,102,119,180,81,77,218,117,218,21,61,105,71,68,101,147,102,55,81,117,96,83,167,145,93,209,17,77,144,25,93,25,17,149,221,17,209,36,97,118,118,84,85,100,183,109,155,29,213,65,67,150,217,217,77,155,25,93,217,29,77,30,68,102,68,84,70,116,101,68,119,68,84,155,157,39,221,105,118,19,157,180,209,21,36,109,101,84,68,118,116,68,69,52,121,214,97,101,71,84,68,116,84,70,84,70,68,68,159,70,84,118,68,69,116,117,118,70,144,102,119,209,54,105,118,84,55,7,54,105,70,84,116,85,69,116,208,68,68,182,65,70,118,111,123,22,65,102,118,159,68,101,84,119,85,69,24,21,217,77,118,86,71,85,85,153,221,118,145,21,77,155,17,29,77,146,