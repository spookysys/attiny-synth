154,154,54,198,135,30,94,249,233,189,30,114,178,237,155,76,178,45,231,108,171,93,208,120,229,144,179,57,246,142,1,27,172,189,16,59,6,108,88,147,212,49,72,12,158,188,6,5,241,122,206,98,64,17,91,147,80,135,83,54,140,228,214,36,215,132,94,155,92,7,74,103,195,19,10,118,198,27,145,28,100,195,89,133,199,145,112,92,202,198,153,159,118,240,230,25,123,218,193,4,118,114,37,17,220,90,181,7,144,49,141,118,206,41,29,188,9,100,67,139,29,123,194,97,222,37,68,75,131,68,47,1,210,228,132,99,27,147,3,65,94,73,209,228,141,236,105,211,224,146,39,61,32,121,112,50,146,199,54,82,4,77,229,22,237,73,99,77,120,64,82,84,208,84,64,65,114,18,117,145,69,19,20,69,96,87,5,100,21,93,21,16,5,132,213,84,148,